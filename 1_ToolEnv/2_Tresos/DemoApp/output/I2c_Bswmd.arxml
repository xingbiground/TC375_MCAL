AUTOSAR XML (schema 4-2-2)
# Copyright (C) Infineon Technologies (2020)
# All rights reserved.
# Copyright (C) Infineon Technologies (2019)
package /AURIX2G_I2c/BswModuleDescriptions
  bsw module description I2c: category=BSW_MODULE, module-id=255  # Inter Integrated Circuit Driver
    provided-entrys:
      I2c_Init
      I2c_DeInit
      I2c_SyncRead
      I2c_AsyncRead
      I2c_SyncWrite
      I2c_AsyncWrite
      I2c_GetStatus
      I2c_CancelOperation
      I2c_IsrI2cDtr
      I2c_IsrI2cProtocol
      I2c_IsrI2cError
    bsw module dependency DetDependency: target-module-id=15, required-entrys=Det_ReportError
    bsw internal behavior I2cBehavior
      6 x bsw called entity, all with reentrancy-level=NON-REENTRANT:
        I2c_Init: implemented-entry=I2c_Init
        I2c_DeInit: implemented-entry=I2c_DeInit
        I2c_SyncRead: implemented-entry=I2c_SyncRead
        I2c_AsyncRead: implemented-entry=I2c_AsyncRead
        I2c_SyncWrite: implemented-entry=I2c_SyncWrite
        I2c_AsyncWrite: implemented-entry=I2c_AsyncWrite
      bsw interrupt entity I2c_IsrI2cDtr: reentrancy-level=NON-REENTRANT, implemented-entry=I2c_IsrI2cDtr
      bsw interrupt entity I2c_IsrI2cProtocol: reentrancy-level=NON-REENTRANT, implemented-entry=I2c_IsrI2cProtocol
      bsw interrupt entity I2c_IsrI2cError: reentrancy-level=NON-REENTRANT, implemented-entry=I2c_IsrI2cError
      bsw called entity I2c_CancelOperation: reentrancy-level=NON-REENTRANT, implemented-entry=I2c_CancelOperation
      bsw called entity I2c_GetStatus: reentrancy-level=SINGLE-CORE-REENTRANT, implemented-entry=I2c_GetStatus
package /AURIX2G_I2c/BswModuleEntrys
  11 x bsw module entry, all with sw-service-impl-policy=STANDARD:
    I2c_Init: service-id=79, is-reentrant=false, is-synchronous=true, call-type=REGULAR, execution-context=TASK
      sw service arg ConfigPtr: category=DATA_REFERENCE, sw-pointer-target-props={target-category=TYPE_REFERENCE, implementation-data-type=I2c_ConfigType}
    I2c_DeInit: service-id=80, is-reentrant=false, is-synchronous=true, call-type=REGULAR, execution-context=TASK
      return type Return: implementation-data-type=Std_ReturnType
    I2c_SyncWrite: service-id=81, is-reentrant=false, is-synchronous=true, call-type=REGULAR, execution-context=TASK
      return type Return: implementation-data-type=I2c_ErrorType
      4 x sw service arg:
        ChannelId: implementation-data-type=I2c_ChannelType
        DataPtr: category=DATA_REFERENCE, sw-pointer-target-props={target-category=TYPE_REFERENCE, implementation-data-type=I2c_DataType}
        Size: implementation-data-type=I2c_SizeType
        SlaveAddress: implementation-data-type=I2c_SlaveAddrType
    I2c_AsyncWrite: service-id=83, is-reentrant=false, is-synchronous=false, call-type=REGULAR, execution-context=TASK
      return type Return: implementation-data-type=I2c_ErrorType
      4 x sw service arg:
        ChannelId: implementation-data-type=I2c_ChannelType
        DataPtr: category=DATA_REFERENCE, sw-pointer-target-props={target-category=TYPE_REFERENCE, implementation-data-type=I2c_DataType}
        Size: implementation-data-type=I2c_SizeType
        SlaveAddress: implementation-data-type=I2c_SlaveAddrType
    I2c_SyncRead: service-id=82, is-reentrant=false, is-synchronous=true, call-type=REGULAR, execution-context=TASK
      return type Return: implementation-data-type=I2c_ErrorType
      4 x sw service arg:
        ChannelId: implementation-data-type=I2c_ChannelType
        DataPtr: category=DATA_REFERENCE, sw-pointer-target-props={target-category=TYPE_REFERENCE, implementation-data-type=I2c_DataType}
        Size: implementation-data-type=I2c_SizeType
        SlaveAddress: implementation-data-type=I2c_SlaveAddrType
    I2c_AsyncRead: service-id=84, is-reentrant=false, is-synchronous=false, call-type=REGULAR, execution-context=TASK
      return type Return: implementation-data-type=I2c_ErrorType
      4 x sw service arg:
        ChannelId: implementation-data-type=I2c_ChannelType
        DataPtr: category=DATA_REFERENCE, sw-pointer-target-props={target-category=TYPE_REFERENCE, implementation-data-type=I2c_DataType}
        Size: implementation-data-type=I2c_SizeType
        SlaveAddress: implementation-data-type=I2c_SlaveAddrType
    I2c_GetStatus: service-id=85, is-reentrant=true, is-synchronous=true, call-type=REGULAR, execution-context=TASK
      return type Return: implementation-data-type=I2c_ChannelStatusType
      sw service arg ChannelId: implementation-data-type=I2c_ChannelType
    I2c_CancelOperation: service-id=86, is-reentrant=false, is-synchronous=true, call-type=REGULAR, execution-context=TASK
      return type Return: implementation-data-type=Std_ReturnType
      sw service arg ChannelId: implementation-data-type=I2c_ChannelType
      sw service arg TransmittedDataSize: category=DATA_REFERENCE, sw-pointer-target-props={target-category=TYPE_REFERENCE, implementation-data-type=I2c_SizeType}
    I2c_IsrI2cDtr: is-reentrant=false, is-synchronous=true, call-type=INTERRUPT, execution-context=INTERRUPT-CAT-1
      sw service arg HwUnit: implementation-data-type=uint8
    I2c_IsrI2cProtocol: is-reentrant=false, is-synchronous=true, call-type=INTERRUPT, execution-context=INTERRUPT-CAT-1
      sw service arg HwUnit: implementation-data-type=uint8
    I2c_IsrI2cError: is-reentrant=false, is-synchronous=true, call-type=INTERRUPT, execution-context=INTERRUPT-CAT-1
      sw service arg HwUnit: implementation-data-type=uint8
package /AURIX2G_I2c/Implementations
  bsw implementation I2c: programming-language=C, sw-version=10.40.1, vendor-id=17, ar-release-version=4.2.2, behavior=I2cBehavior, vendor-specific-module-def=I2c
    code-descriptors:
      code Files: artifact-descriptors=[{short-label=ssc::src::I2c.c, category=SWSRC}, {short-label=ssc::inc::I2c.h, category=SWHDR}]
    generated-artifacts:
      5 x dependency on artifact:
        I2c_PBcfg_c: artifact-descriptor={short-label=generate::src::I2c_PBcfg.c, category=SWTEMPLATE}, usages=EXECUTE
        I2c_PBcfg_h: artifact-descriptor={short-label=generate::inc::I2c_PBcfg.h, category=SWTEMPLATE}, usages=COMPILE
        I2c_Cfg_h: artifact-descriptor={short-label=generate::inc::I2c_Cfg.h, category=SWTEMPLATE}, usages=COMPILE
        I2c_xdm: artifact-descriptor={short-label=config::I2c.xdm, category=SWTOOL}, usages=CODEGENERATION
        I2c_bmd: artifact-descriptor={short-label=autosar::I2c.bmd, category=SWTOOL}, usages=CODEGENERATION
    resource consumption ResourceConsumption
      6 x memory section:
        VAR_CLEARED_QM_LOCAL_8: alignment=8, size=2, sw-addrmethod=VAR
        VAR_CLEARED_QM_LOCAL_32: alignment=32, size=10, sw-addrmethod=VAR
        VAR_CLEARED_QM_LOCAL_UNSPECIFIED: alignment=UNSPECIFIED, size=10, sw-addrmethod=VAR
        CONST_QM_LOCAL_32: alignment=32, size=10, sw-addrmethod=CONST
        CONFIG_DATA_QM_LOCAL_UNSPECIFIED: alignment=UNSPECIFIED, size=20, sw-addrmethod=CONFIG_DATA
        CODE_QM_LOCAL: alignment=UNSPECIFIED, size=20, sw-addrmethod=CODE
      section name prefix I2C
package /AURIX2G_I2c/ImplementationDataTypes
  11 x impl type, all with type-emitter=BSW:
    I2c_ChannelType: implementation-data-type=uint8
    I2c_SizeType: implementation-data-type=uint16
    I2c_DataType: implementation-data-type=uint8
    I2c_SlaveAddrType: implementation-data-type=uint16
    I2c_ChannelStatusType: compu {0=I2C_UNINIT, 0=I2C_IDLE, 0=I2C_BUSY}, implementation-data-type=sint32, additional-native-type-qualifier=enum
    I2c_AddressingModeType: compu {0=I2C_7_BIT_ADDRESSING, 1=I2C_10_BIT_ADDRESSING}, implementation-data-type=sint32, additional-native-type-qualifier=enum
    I2c_ConfigType: category=STRUCTURE
      element I2c_ChannelConfigType: implementation-data-type=I2c_ChannelConfigType
      element I2c_MaxChannels: implementation-data-type=uint8
    I2c_ChannelConfigType: category=STRUCTURE
      12 x element, all with category=TYPE_REFERENCE:
        HwUnit: implementation-data-type=uint8
        AdddressCfgValue: implementation-data-type=uint32
        FracDividerCfgValue: implementation-data-type=uint32
        FracDividerHighCfgValue: implementation-data-type=uint32
        TimingCfgvalue: implementation-data-type=uint32
        FIFOCfgValue: implementation-data-type=uint32
        PortPinCfgvalue: implementation-data-type=uint8
        HWClkSetting: implementation-data-type=uint32
        AddressingMode: implementation-data-type=I2c_AddressingModeType
        I2c_Notif: implementation-data-type=I2c_NotifType
        TxTimeOutCount: implementation-data-type=uint32
        RxTimeOutCount: implementation-data-type=uint32
    I2c_NotifType: category=STRUCTURE
      element I2c_NotifFunctionPtrType: implementation-data-type=I2c_NotifFunctionPtrType
    I2c_ErrorType: compu {0=I2C_NO_ERR, 1=I2C_TX_UNDERFLOW, 2=I2C_TX_OVERFLOW, 3=I2C_RX_UNDERFLOW, 4=I2C_RX_OVERFLOW, 5=I2C_NO_ACK, 6=I2C_ARBITRATION_LOST, 7=I2C_INVALID_CHANNEL, 8=I2C_INVALID_SIZE, 9=I2C_INVALID_ADDRESS, 10=I2C_NULL_PTR, 11=I2C_IS_UNINIT, 12=I2C_IS_BUSY, 13=I2C_ERR_OTHER}, implementation-data-type=sint32, additional-native-type-qualifier=enum
    I2c_NotifFunctionPtrType: category=FUNCTION_REFERENCE, sw-pointer-target-props=I2c_NotifFunction
