AUTOSAR XML (schema 4-2-2)
# Copyright (C) Infineon Technologies (2023)
# All rights reserved.
package /AUTOSAR_Fee/BswModuleDescriptions
  bsw module description Fee: category=BSW_MODULE, module-id=21  # FEE Driver
    provided-entrys:
      Fee_Init
      Fee_SetMode
      Fee_Read
      Fee_Write
      Fee_Cancel
      Fee_GetStatus
      Fee_GetJobResult
      Fee_InvalidateBlock
      Fee_EraseImmediateBlock
      Fee_JobEndNotification
      Fee_JobErrorNotification
      Fee_17_GetCycleCount
      Fee_17_EnableGcStart
      Fee_17_DisableGcStart
      Fee_MainFunction
      Fee_GetVersionInfo
      Fee_17_IllegalStateNotification
      Fee_17_JobEraseErrorNotification
      Fee_17_JobProgErrorNotification
      Fee_17_EraseQuasiStaticData
      Fee_17_GetQuasiStaticBlockInfo
      Fee_17_GetQuasiStaticJobResult
    4 x bsw module dependency:
      McalWrapperDependency: target-module-id=255, required-entrys=Mcal_Wrapper_Dem_ReportErrorStatus
      DetDependency: target-module-id=15, required-entrys=Det_ReportError
      McalSafetyErrorDependency: target-module-id=255, required-entrys=Mcal_ReportSafetyError
      FlsDependency: target-module-id=92
        required-entrys:
          Fls_Read
          Fls_Write
          Fls_Erase
          Fls_ReadWordsSync
          Fls_CompareWordsSync
          Fls_VerifyErase
          Fls_GetNotifCaller
          Fls_CancelNonEraseJobs
          Fls_SetMode
          Fls_GetOperStatus
          Fls_IsHardeningRequired
          Fls_VerifySectorErase
          Fls_MainFunction
        expected-callbacks:
          Fee_JobEndNotification
          Fee_JobErrorNotification
          Fee_17_IllegalStateNotification
          Fee_17_JobEraseErrorNotification
          Fee_17_JobProgErrorNotification
    bsw internal behavior FeeBehavior
      13 x bsw called entity:
        Fee_Init: reentrancy-level=NON-REENTRANT, implemented-entry=Fee_Init
        Fee_SetMode: reentrancy-level=NON-REENTRANT, implemented-entry=Fee_SetMode
        Fee_Read: reentrancy-level=NON-REENTRANT, implemented-entry=Fee_Read
        Fee_Write: reentrancy-level=NON-REENTRANT, implemented-entry=Fee_Write
        Fee_Cancel: reentrancy-level=NON-REENTRANT, implemented-entry=Fee_Cancel
        Fee_GetStatus: reentrancy-level=NON-REENTRANT, implemented-entry=Fee_GetStatus
        Fee_GetJobResult: reentrancy-level=NON-REENTRANT, implemented-entry=Fee_GetJobResult
        Fee_InvalidateBlock: reentrancy-level=NON-REENTRANT, implemented-entry=Fee_InvalidateBlock
        Fee_EraseImmediateBlock: reentrancy-level=NON-REENTRANT, implemented-entry=Fee_EraseImmediateBlock
        Fee_17_GetCycleCount: reentrancy-level=NON-REENTRANT, implemented-entry=Fee_17_GetCycleCount
        Fee_17_EnableGcStart: reentrancy-level=NON-REENTRANT, implemented-entry=Fee_17_EnableGcStart
        Fee_17_DisableGcStart: reentrancy-level=NON-REENTRANT, implemented-entry=Fee_17_DisableGcStart
        Fee_GetVersionInfo: reentrancy-level=SINGLE-CORE-REENTRANT, implemented-entry=Fee_GetVersionInfo
      bsw schedulable entity Fee_MainFunction: minimum-start-interval=0.01, reentrancy-level=NON-REENTRANT, implemented-entry=Fee_MainFunction
      8 x bsw called entity, all with reentrancy-level=NON-REENTRANT:
        Fee_17_IllegalStateNotification: implemented-entry=Fee_17_IllegalStateNotification
        Fee_17_JobEraseErrorNotification: implemented-entry=Fee_17_JobEraseErrorNotification
        Fee_17_JobProgErrorNotification: implemented-entry=Fee_17_JobProgErrorNotification
        Fee_17_EraseQuasiStaticData: implemented-entry=Fee_17_EraseQuasiStaticData
        Fee_17_GetQuasiStaticBlockInfo: implemented-entry=Fee_17_GetQuasiStaticBlockInfo
        Fee_17_GetQuasiStaticJobResult: implemented-entry=Fee_17_GetQuasiStaticJobResult
        Fee_JobEndNotification: implemented-entry=Fee_JobEndNotification
        Fee_JobErrorNotification: implemented-entry=Fee_JobErrorNotification
      bsw timing event TimingEvent_Fee_MainFunction: starts-on-event=Fee_MainFunction, period=0.01
      service-needs:
        diagnostic event needs FEE_E_GC_INIT
      service-needs:
        diagnostic event needs FEE_E_WRITE
      service-needs:
        diagnostic event needs FEE_E_READ
      service-needs:
        diagnostic event needs FEE_E_GC_WRITE
      service-needs:
        diagnostic event needs FEE_E_GC_READ
      service-needs:
        diagnostic event needs FEE_E_GC_ERASE
      service-needs:
        diagnostic event needs FEE_E_INVALIDATE
      service-needs:
        diagnostic event needs FEE_E_WRITE_CYCLES_EXHAUSTED
      service-needs:
        diagnostic event needs FEE_E_GC_TRIG
      service-needs:
        diagnostic event needs FEE_E_UNCONFIG_BLK_EXCEEDED
package /AUTOSAR_Fee/BswModuleEntrys
  22 x bsw module entry, all with execution-context=TASK:
    Fee_Init: service-id=0, is-reentrant=false, is-synchronous=false, call-type=REGULAR, sw-service-impl-policy=STANDARD
      sw service arg ConfigPtr: category=DATA_REFERENCE, sw-pointer-target-props={target-category=TYPE_REFERENCE, implementation-data-type=Fee_ConfigType}
    Fee_SetMode: service-id=1, is-reentrant=false, is-synchronous=true, call-type=REGULAR, sw-service-impl-policy=STANDARD
      sw service arg Mode: implementation-data-type=MemIf_ModeType
    Fee_Read: service-id=2, is-reentrant=false, is-synchronous=false, call-type=REGULAR, sw-service-impl-policy=STANDARD
      return type ReturnValue: implementation-data-type=Std_ReturnType
      4 x sw service arg:
        BlockNumber: implementation-data-type=uint16
        BlockOffset: implementation-data-type=uint16
        DataBufferPtr: category=DATA_REFERENCE, sw-pointer-target-props={target-category=TYPE_REFERENCE, implementation-data-type=uint8}
        Length: implementation-data-type=uint16
    Fee_Write: service-id=3, is-reentrant=false, is-synchronous=false, call-type=REGULAR, sw-service-impl-policy=STANDARD
      return type ReturnValue: implementation-data-type=Std_ReturnType
      sw service arg BlockNumber: implementation-data-type=uint16
      sw service arg DataBufferPtr: category=DATA_REFERENCE, sw-pointer-target-props={target-category=TYPE_REFERENCE, implementation-data-type=uint8}
    Fee_Cancel: service-id=4, is-reentrant=false, is-synchronous=true, call-type=REGULAR, sw-service-impl-policy=STANDARD
    Fee_GetStatus: service-id=5, is-reentrant=false, is-synchronous=true, call-type=REGULAR, sw-service-impl-policy=STANDARD
      return type ReturnValue: implementation-data-type=MemIf_StatusType
    Fee_GetJobResult: service-id=6, is-reentrant=false, is-synchronous=true, call-type=REGULAR, sw-service-impl-policy=STANDARD
      return type ReturnValue: implementation-data-type=MemIf_JobResultType
    Fee_InvalidateBlock: service-id=7, is-reentrant=false, is-synchronous=false, call-type=REGULAR, sw-service-impl-policy=STANDARD
      return type ReturnValue: implementation-data-type=Std_ReturnType
      sw service arg BlockNumber: implementation-data-type=uint16
    Fee_EraseImmediateBlock: service-id=9, is-reentrant=false, is-synchronous=true, call-type=REGULAR, sw-service-impl-policy=STANDARD
      return type ReturnValue: implementation-data-type=Std_ReturnType
      sw service arg BlockNumber: implementation-data-type=uint16
    Fee_JobEndNotification: service-id=16, is-reentrant=false, is-synchronous=true, call-type=CALLBACK, sw-service-impl-policy=STANDARD
    Fee_JobErrorNotification: service-id=17, is-reentrant=false, is-synchronous=true, call-type=CALLBACK, sw-service-impl-policy=STANDARD
    Fee_17_GetCycleCount: service-id=32, is-reentrant=false, is-synchronous=true, call-type=REGULAR, sw-service-impl-policy=STANDARD
      return type Return: implementation-data-type=Std_ReturnType
      sw service arg BlockNumber: implementation-data-type=uint16
      sw service arg CountPtr: category=DATA_REFERENCE, sw-pointer-target-props={target-category=TYPE_REFERENCE, implementation-data-type=uint32}
    Fee_17_EnableGcStart: service-id=33, is-reentrant=false, is-synchronous=true, call-type=REGULAR, sw-service-impl-policy=STANDARD
    Fee_17_DisableGcStart: service-id=34, is-reentrant=false, is-synchronous=true, call-type=REGULAR, sw-service-impl-policy=STANDARD
    Fee_MainFunction: service-id=18, is-reentrant=false, is-synchronous=true, call-type=SCHEDULED, sw-service-impl-policy=STANDARD
    Fee_GetVersionInfo: service-id=8, is-reentrant=true, is-synchronous=true, call-type=REGULAR, sw-service-impl-policy=MACRO
      sw service arg VersioninfoPtr: category=DATA_REFERENCE, sw-pointer-target-props={target-category=TYPE_REFERENCE, implementation-data-type=Std_VersionInfoType}
    Fee_17_IllegalStateNotification: service-id=36, is-reentrant=false, is-synchronous=true, call-type=CALLBACK, sw-service-impl-policy=STANDARD
    Fee_17_JobEraseErrorNotification: service-id=41, is-reentrant=false, is-synchronous=true, call-type=CALLBACK, sw-service-impl-policy=STANDARD
    Fee_17_JobProgErrorNotification: service-id=49, is-reentrant=false, is-synchronous=true, call-type=CALLBACK, sw-service-impl-policy=STANDARD
    Fee_17_EraseQuasiStaticData: service-id=37, is-reentrant=false, is-synchronous=true, call-type=REGULAR, sw-service-impl-policy=STANDARD
      return type Return: implementation-data-type=Std_ReturnType
      sw service arg BlockNumber: implementation-data-type=uint16
      sw service arg Instances: category=DATA_REFERENCE, sw-pointer-target-props={target-category=TYPE_REFERENCE, implementation-data-type=uint16}
    Fee_17_GetQuasiStaticBlockInfo: service-id=38, is-reentrant=false, is-synchronous=true, call-type=REGULAR, sw-service-impl-policy=STANDARD
      return type Return: implementation-data-type=MemIf_JobResultType
      sw service arg BlockNumber: implementation-data-type=uint16
      sw service arg BlockInfoPtr: category=DATA_REFERENCE, sw-pointer-target-props={target-category=TYPE_REFERENCE, implementation-data-type=Fee_QuasiStaticBlockInfoType}
    Fee_17_GetQuasiStaticJobResult: service-id=39, is-reentrant=false, is-synchronous=true, call-type=REGULAR, sw-service-impl-policy=STANDARD
      return type Return: implementation-data-type=MemIf_JobResultType
package /AUTOSAR_Fee/Implementations
  bsw implementation Fee: programming-language=C, sw-version=20.25.0, vendor-id=17, ar-release-version=4.2.2, behavior=FeeBehavior, vendor-specific-module-def=Fee
    code-descriptors:
      code Files
        artifact-descriptors:
          short-label=inc::Fee.h, category=SWHDR
          short-label=inc::Fee_Cbk.h, category=SWHDR
          short-label=src::Fee.c, category=SWSRC
    generated-artifacts:
      5 x dependency on artifact:
        Fee_Cfg_h: artifact-descriptor={short-label=generate::template::inc::Fee_Cfg.h, category=SWTEMPLATE}, usages=COMPILE
        Fee_PBcfg_c: artifact-descriptor={short-label=generate::template::src::Fee_PBcfg.c, category=SWTEMPLATE}, usages=EXECUTE
        Fee_PBcfg_h: artifact-descriptor={short-label=generate::template::inc::Fee_PBcfg.h, category=SWTEMPLATE}, usages=EXECUTE
        Fee_xdm: artifact-descriptor={short-label=config::Fee.xdm, category=SWTOOL}, usages=CODEGENERATION
        Fee_bmd: artifact-descriptor={short-label=autosar::TC37x::TC375x::Fee.bmd, category=SWTOOL}, usages=CODEGENERATION
    resource consumption ResourceConsumption
      11 x memory section:
        CODE_ASIL_B_LOCAL: alignment=UNSPECIFIED, sw-addrmethod=CODE
        JOBENDNOTIF_CODE_ASIL_B_LOCAL: alignment=UNSPECIFIED, sw-addrmethod=CODE
        JOBERRNOTIF_CODE_ASIL_B_LOCAL: alignment=UNSPECIFIED, sw-addrmethod=CODE
        ILLEGALNOTIF_CODE_ASIL_B_LOCAL: alignment=UNSPECIFIED, sw-addrmethod=CODE
        ERASEERRORNOTI_CODE_ASIL_B_LOCAL: alignment=UNSPECIFIED, sw-addrmethod=CODE
        PROGERRORNOTI_CODE_ASIL_B_LOCAL: alignment=UNSPECIFIED, sw-addrmethod=CODE
        VAR_CLEARED_ASIL_B_LOCAL_UNSPECIFIED: alignment=UNSPECIFIED, sw-addrmethod=VAR_CLEARED
        VAR_CLEARED_ASIL_B_LOCAL_32: alignment=32, sw-addrmethod=VAR_CLEARED
        VAR_INIT_ASIL_B_LOCAL_8: alignment=8, sw-addrmethod=VAR_INIT
        CONST_ASIL_B_LOCAL_32: alignment=32, sw-addrmethod=CONST
        CONFIG_DATA_ASIL_B_LOCAL_UNSPECIFIED: alignment=UNSPECIFIED, sw-addrmethod=CONFIG_DATA
      section name prefix FEE
package /AUTOSAR_Fee/ImplementationDataTypes
  16 x impl type, all with type-emitter=BSW:
    Fee_BlockType: category=STRUCTURE
      7 x element, all with category=TYPE_REFERENCE, implementation-data-type=unsigned_int:
        CycleCountLimit: sw-bit-representation=number-of-bits=24
        FeeImmediateData: sw-bit-representation=number-of-bits=8
        BlockNumber: sw-bit-representation=number-of-bits=16
        Size: sw-bit-representation=number-of-bits=16
        Address: sw-bit-representation=number-of-bits=32
        Instances: sw-bit-representation=number-of-bits=16
        FeeUser: sw-bit-representation=number-of-bits=8
    Fee_NotifFunctionPtrType: category=FUNCTION_REFERENCE, sw-pointer-target-props=QsM_JobEndNotification
    Fee_PageType: implementation-data-type=uint16
    Fee_QsBlock_StateType:
      compu {0=FEE_QS_PROG_STATE_ERASE_STARTED, 1=FEE_QS_PROG_STATE_DESTROY, 2=FEE_QS_PROG_STATE_ERASE_COMPLETE, 3=FEE_QS_PROG_STATE_WRITE_COMPLETE, 4=FEE_QS_PROG_STATE_WRITE_STARTED, 5=FEE_QS_START_ERASE, 6=FEE_QS_START_BCC_WRITE, 7=FEE_QS_START_BLOCK_WRITE, 8=FEE_QS_ERASE_COMPLETE, 9=FEE_QS_DIRTY_ERASE, 10=FEE_QS_WRITE_COMPLETE, 11=FEE_QS_DIRTY_WRITE, 12=FEE_QS_ERASE_STARTED, 13=FEE_QS_WRITE_STARTED, 14=FEE_QS_DESTROY, 25=FEE_QS_INVALID}
      implementation-data-type=uint32
      additional-native-type-qualifier=enum
    Fee_CacheStatusType: category=STRUCTURE
      9 x element, all with category=TYPE_REFERENCE, implementation-data-type=unsigned_int:
        Valid: sw-bit-representation=number-of-bits=1
        Consistent: sw-bit-representation=number-of-bits=1
        Copied: sw-bit-representation=number-of-bits=1
        PrevCopyValid: sw-bit-representation=number-of-bits=1
        PrevCopyConsistent: sw-bit-representation=number-of-bits=1
        PrevCopyCopied: sw-bit-representation=number-of-bits=1
        State: sw-bit-representation=number-of-bits=8
        QsDirtyErase: sw-bit-representation=number-of-bits=1
        QsDirtyWrite: sw-bit-representation=number-of-bits=1
    Fee_CacheType: category=STRUCTURE
      7 x element, all with category=TYPE_REFERENCE:
        Address: implementation-data-type=uint32
        BlockSize: implementation-data-type=uint32
        BlockNumber: implementation-data-type=uint16
        Status: implementation-data-type=Fee_CacheStatusType
        PrevCopyAddress: implementation-data-type=uint32
        PrevBlkSize: implementation-data-type=uint32
        Blkcylcnt: implementation-data-type=uint16
    Fee_ConfigType: category=STRUCTURE
      11 x element:
        FeeStatePtr: category=DATA_REFERENCE, sw-pointer-target-props={target-category=TYPE_REFERENCE, implementation-data-type=Fee_StateDataType}
        FeeBlockConfigPtr: category=DATA_REFERENCE, sw-pointer-target-props={target-category=TYPE_REFERENCE, implementation-data-type=Fee_BlockType}
        FeeNvmJobEndNotification: implementation-data-type=Fee_NotifFunctionPtrType
        FeeNvmJobErrorNotification: implementation-data-type=Fee_NotifFunctionPtrType
        FeeQsJobEndNotification: implementation-data-type=Fee_NotifFunctionPtrType
        FeeQsJobErrorNotification: implementation-data-type=Fee_NotifFunctionPtrType
        FeeThresholdLimit: implementation-data-type=uint32
        FeeBlkCnt: implementation-data-type=uint16
        FeeGCConfigSetting: implementation-data-type=Fee_GCConfigType
        FeeIllegalStateNotification: implementation-data-type=Fee_NotifFunctionPtrType
        FeeEraseAllEnable: implementation-data-type=boolean
    Fee_GcBlkInfoType: category=STRUCTURE
      4 x element, all with category=TYPE_REFERENCE:
        Addr: implementation-data-type=uint32
        PageCount: implementation-data-type=Fee_PageType
        BlockNumber: implementation-data-type=uint16
        Consistent: implementation-data-type=uint8
    Fee_GCConfigType: category=STRUCTURE
      4 x element, all with category=TYPE_REFERENCE, implementation-data-type=unsigned_int:
        FeeUnconfigBlock: sw-bit-representation=number-of-bits=1
        FeeUseEraseSuspend: sw-bit-representation=number-of-bits=1
        unused: sw-bit-representation=number-of-bits=5
        FeeGcRestartPoint: sw-bit-representation=number-of-bits=1
    Fee_LastWrittenBlkInfoType: category=STRUCTURE
      4 x element, all with category=TYPE_REFERENCE:
        Addr: implementation-data-type=uint32
        PageCount: implementation-data-type=Fee_PageType
        BlockNumber: implementation-data-type=uint16
        Status: implementation-data-type=Fee_CacheStatusType
    Fee_PendReqBufType: category=STRUCTURE
      8 x element:
        DataBufferPtr: category=DATA_REFERENCE, sw-pointer-target-props={target-category=TYPE_REFERENCE, implementation-data-type=uint8}
        DataWriteBufferPtr: category=DATA_REFERENCE, sw-pointer-target-props={target-category=TYPE_REFERENCE, implementation-data-type=uint8}
        BlockNumber: implementation-data-type=uint16
        BlockOffset: implementation-data-type=uint16
        Length: implementation-data-type=uint16
        GetPrevCopy: implementation-data-type=uint8
        CacheIndex: implementation-data-type=uint16
        BlockInstances: implementation-data-type=uint8
    Fee_QuasiStaticBlockInfoType: category=STRUCTURE
      element Bcc: implementation-data-type=uint16
      element State: implementation-data-type=Fee_QsBlock_StateType
    Fee_SectorInfoType: category=STRUCTURE
      10 x element, all with category=TYPE_REFERENCE:
        StateCount: implementation-data-type=uint32
        UnerasableWLAddr: array-size=2, array-size-semantics=FIXED-SIZE, implementation-data-type=uint32
        NonZeroWLCount: implementation-data-type=uint32
        NonZeroWLAddr: array-size=3, array-size-semantics=FIXED-SIZE, implementation-data-type=uint32
        StatePageAddr: implementation-data-type=uint32
        NextFreeWLAddr: implementation-data-type=uint32
        QsHardeningOffset: implementation-data-type=uint16
        UnerasableWLCount: implementation-data-type=uint8
        State: implementation-data-type=uint8
        Status: implementation-data-type=Fee_SectorStatusType
    Fee_SectorStatusType: category=STRUCTURE
      element Dirty: sw-bit-representation=number-of-bits=1, implementation-data-type=unsigned_int
      element Used: sw-bit-representation=number-of-bits=1, implementation-data-type=unsigned_int
      element unused: sw-bit-representation=number-of-bits=6, implementation-data-type=unsigned_int
    Fee_StateDataType: category=STRUCTURE
      73 x element:
        FeeSectorInfo: array-size=2, array-size-semantics=FIXED-SIZE, implementation-data-type=Fee_SectorInfoType
        FeeBlockInfo: array-size=13, array-size-semantics=FIXED-SIZE, implementation-data-type=Fee_CacheType
        FeeLastWrittenBlkInfo: implementation-data-type=Fee_LastWrittenBlkInfoType
        FeeGcCurrBlkInfo: implementation-data-type=Fee_GcBlkInfoType
        FeePendReqInfo: implementation-data-type=Fee_PendReqBufType
        FeeGcLWBGcSrcAddr: array-size=32, array-size-semantics=FIXED-SIZE, implementation-data-type=uint32
        FeeTempArray: array-size=2, array-size-semantics=FIXED-SIZE, implementation-data-type=uint32
        FeeStateCount: implementation-data-type=uint32
        FeeReadWriteBuffer: array-size=512, array-size-semantics=FIXED-SIZE, implementation-data-type=uint8
        FeeGcReadWriteBuffer: array-size=512, array-size-semantics=FIXED-SIZE, implementation-data-type=uint8
        FeeLastWrittenBlkBuffer: array-size=512, array-size-semantics=FIXED-SIZE, implementation-data-type=uint8
        FeeGcDestAddr: implementation-data-type=uint32
        FeeGcSrcAddr: implementation-data-type=uint32
        FeeNextFreePageAddr: implementation-data-type=uint32
        FeeWriteAffectedAddr: implementation-data-type=uint32
        FeeBlockStartAddr: implementation-data-type=uint32
        FeeCurrSectSrcAddr: implementation-data-type=uint32
        FeeUnErasableWLAddrTemp: array-size=2, array-size-semantics=FIXED-SIZE, implementation-data-type=uint32
        FeeUserReadDestPtr: category=DATA_REFERENCE, sw-pointer-target-props={target-category=TYPE_REFERENCE, implementation-data-type=uint8}
        FeeJobResult: implementation-data-type=MemIf_JobResultType
        FeeLastWriteSize: implementation-data-type=Fls_17_Dmu_LengthType
        FeeLastReadSize: implementation-data-type=Fls_17_Dmu_LengthType
        FeeComparedLen: implementation-data-type=uint16
        FeeReadLen: implementation-data-type=uint16
        FeeBlkPageCount: implementation-data-type=Fee_PageType
        FeeUserWriteBytesCount: implementation-data-type=uint16
        FeeCurrReqBlockNum: implementation-data-type=uint16
        FeeIntrCurrReqPageCount: implementation-data-type=uint16
        FeeGCCopyIndex: implementation-data-type=uint16
        FeeGCUnconfigBlkCopyIndex: implementation-data-type=uint16
        FeeUnConfigBlockCount: implementation-data-type=uint16
        FeeGcPrevBlockNumber: implementation-data-type=uint16
        FeeGcFirstBlkNumInWL: implementation-data-type=uint16
        FeeStatusFlags: implementation-data-type=Fee_StatusFlagsType
        FeeLastWrittenBlockDirty: implementation-data-type=uint8
        FeePendReqStatus: implementation-data-type=uint8
        FeeGcState: implementation-data-type=uint8
        FeeGcResumeState: implementation-data-type=uint8
        FeeGcBlkIndexInWL: implementation-data-type=uint8
        FeeInitGCState: implementation-data-type=uint8
        FeePrepDFLASHState: implementation-data-type=uint8
        FeeCacheState: implementation-data-type=uint8
        FeeRepairStep: implementation-data-type=uint8
        FeeWLAffectedType: implementation-data-type=uint8
        FeeIntrJob: implementation-data-type=uint8
        FeeIntrJobStatus: implementation-data-type=uint8
        FeeUserJobStatus: implementation-data-type=uint8
        FeeIntrJobResult: implementation-data-type=uint8
        FeeUserJobResult: implementation-data-type=uint8
        FeeMainJob: implementation-data-type=uint8
        FeeUserJobFailCount: implementation-data-type=uint8
        FeeIntrJobFailCount: implementation-data-type=uint8
        FeeUncfgBlksExceeded: implementation-data-type=uint8
        FeeUnErasableWLCountTemp: implementation-data-type=uint8
        FeeSectorCount: implementation-data-type=uint8
        FeeEraseSuspendStatus: implementation-data-type=uint8
        FeeEraseResumeDemReported: implementation-data-type=uint8
        FeeQuasiBlkInstanceTemp: implementation-data-type=uint8
        FeeQsEraseSuspend: implementation-data-type=uint8
        FeeQsState: implementation-data-type=uint8
        FeeQsJob: implementation-data-type=uint8
        FeeQsJobStatus: implementation-data-type=uint8
        FeeQsRepairIndex: implementation-data-type=uint8
        FeeInitQSState: implementation-data-type=uint8
        FeeQsJobResult: implementation-data-type=MemIf_JobResultType
        FeePendEraseInfo: implementation-data-type=Fee_PendReqBufType
        FeeTempPendQsInfo: implementation-data-type=Fee_PendReqBufType
        FeeHardeningCount: implementation-data-type=uint32
        FeeQsHardeningOffset: implementation-data-type=uint16
        FeeQsCancelAll: implementation-data-type=boolean
        FeeHardenFlag: implementation-data-type=uint8
        FeeDisableGCStart: implementation-data-type=boolean
        FeeGCImmBlkWrite: implementation-data-type=boolean
    Fee_StatusFlagsType: category=STRUCTURE
      7 x element, all with category=TYPE_REFERENCE, implementation-data-type=unsigned_int:
        FeeBlkModified: sw-bit-representation=number-of-bits=1
        FeeWriteInvldAPICalled: sw-bit-representation=number-of-bits=1
        unused: sw-bit-representation=number-of-bits=2
        FeeStartInitGC: sw-bit-representation=number-of-bits=1
        FeeCurrSector: sw-bit-representation=number-of-bits=1
        FeeInitAPICalled: sw-bit-representation=number-of-bits=1
        FeeBlkInvalidStatus: sw-bit-representation=number-of-bits=1
