AUTOSAR XML (schema 4-2-2)
# Copyright (C) Infineon Technologies (2021)
# All rights reserved.
package /AURIX2G_Smu/BswModuleDescriptions
  bsw module description Smu: category=BSW_MODULE, module-id=255  # SMU Driver
    provided-entrys:
      Smu_Init
      Smu_DeInit
      Smu_GetAlarmStatus
      Smu_ClearAlarmStatus
      Smu_SetAlarmStatus
      Smu_SetAlarmAction
      Smu_GetAlarmAction
      Smu_LockConfigRegs
      Smu_SetupErrorPin
      Smu_ReleaseErrorPin
      Smu_ReleaseFSP
      Smu_ActivateFSP
      Smu_ActivateRunState
      Smu_CoreAliveTest
      Smu_RTStop
      Smu_GetRTMissedEvent
      Smu_GetAlarmDebugStatus
      Smu_GetSmuState
      Smu_ActivatePES
      Smu_GetAlarmExecutionStatus
      Smu_ClearAlarmExecutionStatus
      Smu_RegisterMonitor
      Smu_InitCheck
    bsw module dependency DetDependency: target-module-id=15, required-entrys=Det_ReportError
    bsw module dependency McalLibDependency: target-module-id=255
      required-entrys:
        Mcal_WriteSafetyEndInitProtReg
        Mcal_WriteSafetyEndInitProtRegMask
        Mcal_GetSpinlock
        Mcal_GetCpuIndex
        Mcal_ReleaseSpinlock
    bsw module dependency McalSafetyErrorDependency: target-module-id=255, required-entrys=Mcal_ReportSafetyError
    bsw internal behavior SmuBehavior
      exclusive area CmdAccess
      exclusive area DriverAccess
      23 x bsw called entity:
        Smu_Init: reentrancy-level=NON-REENTRANT, implemented-entry=Smu_Init
        Smu_DeInit: reentrancy-level=NON-REENTRANT, implemented-entry=Smu_DeInit
        Smu_ClearAlarmStatus: can-enter-exclusive-area=DriverAccess, reentrancy-level=MULTICORE-REENTRANT, implemented-entry=Smu_ClearAlarmStatus
        Smu_SetAlarmStatus: can-enter-exclusive-area=DriverAccess, reentrancy-level=MULTICORE-REENTRANT, implemented-entry=Smu_SetAlarmStatus
        Smu_GetAlarmStatus: reentrancy-level=MULTICORE-REENTRANT, implemented-entry=Smu_GetAlarmStatus
        Smu_GetAlarmDebugStatus: reentrancy-level=MULTICORE-REENTRANT, implemented-entry=Smu_GetAlarmDebugStatus
        Smu_GetAlarmAction: reentrancy-level=MULTICORE-REENTRANT, implemented-entry=Smu_GetAlarmAction
        Smu_SetAlarmAction: can-enter-exclusive-area=DriverAccess, reentrancy-level=MULTICORE-REENTRANT, implemented-entry=Smu_SetAlarmAction
        Smu_ReleaseFSP: can-enter-exclusive-area=CmdAccess, reentrancy-level=NON-REENTRANT, implemented-entry=Smu_ReleaseFSP
        Smu_ActivateFSP: can-enter-exclusive-area=CmdAccess, reentrancy-level=MULTICORE-REENTRANT, implemented-entry=Smu_ActivateFSP
        Smu_SetupErrorPin: can-enter-exclusive-area=DriverAccess, reentrancy-level=MULTICORE-REENTRANT, implemented-entry=Smu_SetupErrorPin
        Smu_ReleaseErrorPin: can-enter-exclusive-area=DriverAccess, reentrancy-level=MULTICORE-REENTRANT, implemented-entry=Smu_ReleaseErrorPin
        Smu_RTStop: can-enter-exclusive-area=DriverAccess, reentrancy-level=MULTICORE-REENTRANT, implemented-entry=Smu_RTStop
        Smu_GetRTMissedEvent: can-enter-exclusive-area=DriverAccess, reentrancy-level=MULTICORE-REENTRANT, implemented-entry=Smu_GetRTMissedEvent
        Smu_LockConfigRegs: can-enter-exclusive-area=DriverAccess, reentrancy-level=NON-REENTRANT, implemented-entry=Smu_LockConfigRegs
        Smu_GetSmuState: reentrancy-level=MULTICORE-REENTRANT, implemented-entry=Smu_GetSmuState
        Smu_ActivateRunState: can-enter-exclusive-area=CmdAccess, reentrancy-level=NON-REENTRANT, implemented-entry=Smu_ActivateRunState
        Smu_ActivatePES: can-enter-exclusive-area=DriverAccess, reentrancy-level=MULTICORE-REENTRANT, implemented-entry=Smu_ActivatePES
        Smu_CoreAliveTest: can-enter-exclusive-area=CmdAccess, reentrancy-level=MULTICORE-REENTRANT, implemented-entry=Smu_CoreAliveTest
        Smu_GetAlarmExecutionStatus: reentrancy-level=MULTICORE-REENTRANT, implemented-entry=Smu_GetAlarmExecutionStatus
        Smu_ClearAlarmExecutionStatus: can-enter-exclusive-area=DriverAccess, reentrancy-level=MULTICORE-REENTRANT, implemented-entry=Smu_ClearAlarmExecutionStatus
        Smu_RegisterMonitor: can-enter-exclusive-area=DriverAccess, reentrancy-level=MULTICORE-REENTRANT, implemented-entry=Smu_RegisterMonitor
        Smu_InitCheck: reentrancy-level=NON-REENTRANT, implemented-entry=Smu_InitCheck
package /AURIX2G_Smu/BswModuleEntrys
  23 x bsw module entry, all with call-type=REGULAR, execution-context=TASK, sw-service-impl-policy=STANDARD:
    Smu_Init: service-id=168, is-reentrant=false, is-synchronous=true
      return type Return: implementation-data-type=Std_ReturnType
      sw service arg ConfigPtr: category=DATA_REFERENCE, sw-pointer-target-props={target-category=TYPE_REFERENCE, implementation-data-type=Smu_ConfigType}
    Smu_DeInit: service-id=170, is-reentrant=false, is-synchronous=true
      return type Return: implementation-data-type=Std_ReturnType
    Smu_ClearAlarmStatus: service-id=173, is-reentrant=true, is-synchronous=true
      return type Return: implementation-data-type=Std_ReturnType
      sw service arg AlarmGroup: implementation-data-type=Smu_AlarmGroupId
      sw service arg AlarmPos: implementation-data-type=Smu_AlarmIdType
    Smu_SetAlarmStatus: service-id=174, is-reentrant=true, is-synchronous=true
      sw service arg Return: implementation-data-type=Std_ReturnType
      sw service arg AlarmGroup: implementation-data-type=Smu_AlarmGroupId
      sw service arg AlarmPos: implementation-data-type=Smu_AlarmIdType
    Smu_GetAlarmStatus: service-id=175, is-reentrant=true, is-synchronous=false
      sw service arg Return: implementation-data-type=Std_ReturnType
      sw service arg AlarmGroup: implementation-data-type=Smu_AlarmGroupId
      sw service arg AlarmStatus: category=DATA_REFERENCE, sw-pointer-target-props={target-category=TYPE_REFERENCE, implementation-data-type=uint32}
    Smu_GetAlarmDebugStatus: service-id=176, is-reentrant=true, is-synchronous=true
      return type Return: implementation-data-type=Std_ReturnType
      sw service arg AlarmGroup: implementation-data-type=Smu_AlarmGroupId
      sw service arg AlarmStatus: category=DATA_REFERENCE, sw-pointer-target-props={target-category=TYPE_REFERENCE, implementation-data-type=uint32}
    Smu_GetAlarmAction: service-id=171, is-reentrant=true, is-synchronous=true
      return type Return: implementation-data-type=Std_ReturnType
      4 x sw service arg:
        AlarmGroup: implementation-data-type=Smu_AlarmGroupId
        AlarmPos: implementation-data-type=Smu_AlarmIdType
        IntAlarmAction: category=DATA_REFERENCE, sw-pointer-target-props={target-category=TYPE_REFERENCE, implementation-data-type=Smu_CoreAlarmActionType}
        FSPAction: category=DATA_REFERENCE, sw-pointer-target-props={target-category=TYPE_REFERENCE, implementation-data-type=Smu_FSPActionType}
    Smu_SetAlarmAction: service-id=172, is-reentrant=true, is-synchronous=true
      5 x sw service arg, all with category=TYPE_REFERENCE:
        Return: implementation-data-type=Std_ReturnType
        AlarmGroup: implementation-data-type=Smu_AlarmGroupId
        AlarmPos: implementation-data-type=Smu_AlarmIdType
        AlarmAction: implementation-data-type=Smu_CoreAlarmActionType
        FSPAction: implementation-data-type=Smu_FSPActionType
    Smu_ReleaseFSP: service-id=178, is-reentrant=false, is-synchronous=true
      return type Return: implementation-data-type=Std_ReturnType
    Smu_ActivateFSP: service-id=179, is-reentrant=true, is-synchronous=true
      return type Return: implementation-data-type=Std_ReturnType
    Smu_SetupErrorPin: service-id=180, is-reentrant=true, is-synchronous=true
      return type Return: implementation-data-type=Std_ReturnType
    Smu_ReleaseErrorPin: service-id=181, is-reentrant=true, is-synchronous=true
      return type Return: implementation-data-type=Std_ReturnType
    Smu_RTStop: service-id=182, is-reentrant=true, is-synchronous=true
      return type Return: implementation-data-type=Std_ReturnType
      sw service arg TimerNum: implementation-data-type=uint8
    Smu_LockConfigRegs: service-id=177, is-reentrant=false, is-synchronous=true
      return type Return: implementation-data-type=Std_ReturnType
    Smu_ActivatePES: service-id=184, is-reentrant=true, is-synchronous=true
      return type Return: implementation-data-type=Std_ReturnType
    Smu_CoreAliveTest: service-id=189, is-reentrant=true, is-synchronous=true
      return type Return: implementation-data-type=Std_ReturnType
    Smu_ActivateRunState: service-id=187, is-reentrant=false, is-synchronous=true
      return type Return: implementation-data-type=Std_ReturnType
      sw service arg Cmd: implementation-data-type=uint32
    Smu_GetRTMissedEvent: service-id=183, is-reentrant=true, is-synchronous=true
      return type Return: implementation-data-type=Std_ReturnType
      sw service arg TimerNum: implementation-data-type=uint8
      sw service arg EventMissed: category=DATA_REFERENCE, sw-pointer-target-props={target-category=TYPE_REFERENCE, implementation-data-type=boolean}
    Smu_GetSmuState: service-id=186, is-reentrant=true, is-synchronous=true
      return type Return: implementation-data-type=Smu_CoreStateType
    Smu_GetAlarmExecutionStatus: service-id=190, is-reentrant=true, is-synchronous=true
      return type Return: implementation-data-type=Std_ReturnType
      sw service arg AlarmExecStatusReq: implementation-data-type=uint32
      sw service arg AlarmExecStatus: category=DATA_REFERENCE, sw-pointer-target-props={target-category=TYPE_REFERENCE, implementation-data-type=uint32}
    Smu_ClearAlarmExecutionStatus: service-id=191, is-reentrant=true, is-synchronous=true
      return type Return: implementation-data-type=Std_ReturnType
      sw service arg AlarmExecStatusReq: implementation-data-type=uint32
    Smu_RegisterMonitor: service-id=185, is-reentrant=true, is-synchronous=true
      return type Return: implementation-data-type=Std_ReturnType
      sw service arg RegMonPtr: category=DATA_REFERENCE, sw-pointer-target-props={target-category=TYPE_REFERENCE, implementation-data-type=uint16}
      sw service arg RegMonResult: category=DATA_REFERENCE, sw-pointer-target-props={target-category=TYPE_REFERENCE, implementation-data-type=Smu_SffTestResType}
    Smu_InitCheck: service-id=169, is-reentrant=false, is-synchronous=true
      return type Return: implementation-data-type=Std_ReturnType
      sw service arg ConfigPtr: category=DATA_REFERENCE, sw-pointer-target-props={target-category=TYPE_REFERENCE, implementation-data-type=Smu_ConfigType}
package /AURIX2G_Smu/ImplementationDataTypes
  9 x impl type, all with type-emitter=BSW:
    Smu_AlarmGroupId: compu {0..11=SMU_GROUP_0..SMU_GROUP_11, 20=SMU_GROUP_20, 21=SMU_GROUP_21}, implementation-data-type=sint32, additional-native-type-qualifier=enum
    Smu_AlarmIdType: compu {0..31=SMU_ALARM_0..SMU_ALARM_31}, implementation-data-type=sint32, additional-native-type-qualifier=enum
    Smu_CoreAlarmActionType: implementation-data-type=uint8
    Smu_CoreCommandType: implementation-data-type=uint8
    Smu_CoreStateType: implementation-data-type=uint8
    Smu_EnableRunStateType: compu {0=SMU_EFRST_DISABLE, 1=SMU_EFRST_ENABLE}, implementation-data-type=sint32, additional-native-type-qualifier=enum
    Smu_FSPActionType: implementation-data-type=uint32
    Smu_SffTestResType: implementation-data-type=uint8
    Smu_ConfigType: category=STRUCTURE
      11 x element, all with category=TYPE_REFERENCE, implementation-data-type=uint32:
        FSPCfg
        AGCCfg
        RTCCfg
        RTAC00Cfg
        RTAC01Cfg
        RTAC10Cfg
        RTAC11Cfg
        CMDSTDBYCfg
        AlarmConfig: array-size=32, array-size-semantics=FIXED-SIZE
        AlarmFspConfig: array-size=12, array-size-semantics=FIXED-SIZE
        AlarmStdbyFspConfig: array-size=2, array-size-semantics=FIXED-SIZE
package /AURIX2G_Smu/Implementations
  bsw implementation Smu: programming-language=C, sw-version=20.25.0, vendor-id=17, ar-release-version=4.2.2, behavior=SmuBehavior, vendor-specific-module-def=Smu
    code-descriptors:
      code Files: artifact-descriptors=[{short-label=ssc::src::Smu.c, category=SWSRC}, {short-label=ssc::inc::Smu.h, category=SWHDR}]
    generated-artifacts:
      6 x dependency on artifact:
        Smu_PBcfg_c: artifact-descriptor={short-label=generate::template::src::Smu_PBcfg.c, category=SWTEMPLATE}, usages=EXECUTE
        Smu_Cfg_h: artifact-descriptor={short-label=generate::template::inc::Smu_Cfg.h, category=SWTEMPLATE}, usages=COMPILE
        Smu_PBcfg_h: artifact-descriptor={short-label=generate::template::inc::Smu_PBcfg.h, category=SWTEMPLATE}, usages=EXECUTE
        Smu_xdm: artifact-descriptor={short-label=config::Smu.xdm, category=SWTOOL}, usages=CODEGENERATION
        SmuPreConfiguration_xdm: artifact-descriptor={short-label=config::SmuPreConfiguration.xdm, category=SWTOOL}, usages=CODEGENERATION
        Smu_bmd: artifact-descriptor={short-label=autosar::TC37x::TC377x::Smu.bmd, category=SWTOOL}, usages=CODEGENERATION
    resource consumption ResourceConsumption
      memory section CONFIG_DATA_ASIL_B_GLOBAL_UNSPECIFIED: alignment=UNSPECIFIED, sw-addrmethod=CONFIG_DATA
      memory section VAR_INIT_ASIL_B_GLOBAL_32: alignment=32, sw-addrmethod=VAR_INIT
      memory section CODE_ASIL_B_GLOBAL: alignment=UNSPECIFIED, sw-addrmethod=CODE
      section name prefix SMU
