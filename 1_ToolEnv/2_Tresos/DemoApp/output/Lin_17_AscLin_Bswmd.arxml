AUTOSAR XML (schema 4-2-2)
# Copyright (C) Infineon Technologies (2023)
# All rights reserved.
package /AUTOSAR_Lin_17_AscLin/BswModuleDescriptions
  bsw module description Lin: category=BSW_MODULE, module-id=82  # LIN Driver
    provided-entrys:
      Lin_Init
      Lin_CheckWakeup
      Lin_SendFrame
      Lin_GoToSleep
      Lin_GoToSleepInternal
      Lin_Wakeup
      Lin_WakeupInternal
      Lin_GetStatus
      Lin_IsrReceive
      Lin_IsrTransmit
      Lin_IsrError
    4 x bsw module dependency:
      DetDependency: target-module-id=15, required-entrys=Det_ReportError
      McalLibDependency: target-module-id=255, required-entrys=Mcal_WritePeripEndInitProtReg
      LinIfDependency: target-module-id=62, required-entrys=LinIf_WakeupConfirmation
      EcuMDependency: target-module-id=10, required-entrys=[EcuM_SetWakeupEvent, EcuM_CheckWakeup]
    bsw internal behavior LinBehavior
      8 x bsw called entity, all with reentrancy-level=NON-REENTRANT:
        Lin_Init: implemented-entry=Lin_Init
        Lin_CheckWakeup: implemented-entry=Lin_CheckWakeup
        Lin_SendFrame: implemented-entry=Lin_SendFrame
        Lin_GoToSleep: implemented-entry=Lin_GoToSleep
        Lin_GoToSleepInternal: implemented-entry=Lin_GoToSleepInternal
        Lin_Wakeup: implemented-entry=Lin_Wakeup
        Lin_WakeupInternal: implemented-entry=Lin_WakeupInternal
        Lin_GetStatus: implemented-entry=Lin_GetStatus
      bsw interrupt entity Lin_IsrReceive: reentrancy-level=MULTICORE-REENTRANT, implemented-entry=Lin_IsrReceive
      bsw interrupt entity Lin_IsrTransmit: reentrancy-level=MULTICORE-REENTRANT, implemented-entry=Lin_IsrTransmit
      bsw interrupt entity Lin_IsrError: reentrancy-level=MULTICORE-REENTRANT, implemented-entry=Lin_IsrError
package /AUTOSAR_Lin_17_AscLin/BswModuleEntrys
  11 x bsw module entry, all with sw-service-impl-policy=STANDARD:
    Lin_Init: service-id=0, is-reentrant=false, is-synchronous=true, call-type=REGULAR, execution-context=TASK
      sw service arg Config: category=DATA_REFERENCE, sw-pointer-target-props={target-category=TYPE_REFERENCE, implementation-data-type=Lin_17_AscLin_ConfigType}
    Lin_CheckWakeup: service-id=10, is-reentrant=false, is-synchronous=true, call-type=REGULAR, execution-context=TASK
      return type Return: implementation-data-type=Std_ReturnType
      sw service arg Channel: implementation-data-type=uint8
    Lin_SendFrame: service-id=4, is-reentrant=false, is-synchronous=false, call-type=REGULAR, execution-context=TASK
      return type Return: implementation-data-type=Std_ReturnType
      sw service arg Channel: implementation-data-type=uint8
      sw service arg PduInfoPtr: category=DATA_REFERENCE, sw-pointer-target-props={target-category=TYPE_REFERENCE, implementation-data-type=Lin_PduType}
    Lin_GoToSleep: service-id=6, is-reentrant=false, is-synchronous=false, call-type=REGULAR, execution-context=TASK
      return type Return: implementation-data-type=Std_ReturnType
      sw service arg Channel: implementation-data-type=uint8
    Lin_GoToSleepInternal: service-id=9, is-reentrant=false, is-synchronous=true, call-type=REGULAR, execution-context=TASK
      return type Return: implementation-data-type=Std_ReturnType
      sw service arg Channel: implementation-data-type=uint8
    Lin_Wakeup: service-id=7, is-reentrant=false, is-synchronous=false, call-type=REGULAR, execution-context=TASK
      return type Return: implementation-data-type=Std_ReturnType
      sw service arg Channel: implementation-data-type=uint8
    Lin_WakeupInternal: service-id=11, is-reentrant=false, is-synchronous=false, call-type=REGULAR, execution-context=TASK
      return type Return: implementation-data-type=Std_ReturnType
      sw service arg Channel: implementation-data-type=uint8
    Lin_GetStatus: service-id=8, is-reentrant=false, is-synchronous=true, call-type=REGULAR, execution-context=TASK
      return type Return: implementation-data-type=Lin_StatusType
      sw service arg Channel: implementation-data-type=uint8
      sw service arg LinSduPtr: category=DATA_REFERENCE, sw-pointer-target-props={target-category=TYPE_REFERENCE, implementation-data-type=uint8}
    Lin_IsrReceive: role=Lin_IsrReceive, is-reentrant=true, is-synchronous=true, call-type=INTERRUPT, execution-context=INTERRUPT-CAT-1
      sw service arg HwUnit: implementation-data-type=uint8
    Lin_IsrTransmit: role=Lin_IsrTransmit, is-reentrant=true, is-synchronous=true, call-type=INTERRUPT, execution-context=INTERRUPT-CAT-1
      sw service arg HwUnit: implementation-data-type=uint8
    Lin_IsrError: role=Lin_IsrError, is-reentrant=true, is-synchronous=true, call-type=INTERRUPT, execution-context=INTERRUPT-CAT-1
      sw service arg HwUnit: implementation-data-type=uint8
package /AUTOSAR_Lin_17_AscLin/Implementations
  bsw implementation Lin: programming-language=C, sw-version=20.25.0, vendor-id=17, ar-release-version=4.2.2, behavior=LinBehavior, vendor-api-infix=AscLin, vendor-specific-module-def=Lin
    code-descriptors:
      code Files: artifact-descriptors=[{short-label=src::Lin_17_AscLin.c, category=SWSRC}, {short-label=inc::Lin_17_AscLin.h, category=SWHDR}]
    generated-artifacts:
      5 x dependency on artifact:
        Lin_PBCfg_c: artifact-descriptor={short-label=plugins::Lin_17_AscLin_Aurix::generate::src::Lin_17_AscLin_PBcfg.c, category=SWTEMPLATE}, usages=EXECUTE
        Lin_Cfg_h: artifact-descriptor={short-label=plugins::Lin_17_AscLin_Aurix::generate::inc::Lin_17_AscLin_Cfg.h, category=SWTEMPLATE}, usages=COMPILE
        Lin_17_AscLin_PBcfg_h: artifact-descriptor={short-label=generate::template::inc::Lin_17_AscLin_PBcfg.h, category=SWTEMPLATE}, usages=EXECUTE
        Lin_m: artifact-descriptor={short-label=plugins::Lin_17_AscLin_Aurix::generate::Lin_17_AscLin.m, category=SWTOOL}, usages=CODEGENERATION
        Lin_17_AscLin_bmd: artifact-descriptor={short-label=autosar::TC37x::TC377x::Lin_17_AscLin.bmd, category=SWTOOL}, usages=CODEGENERATION
    resource consumption ResourceConsumption
      7 x memory section, all with alignment=UNSPECIFIED:
        CONST_QM_GLOBAL_UNSPECIFIED: sw-addrmethod=VAR_CLEARED
        CODE_QM_GLOBAL: sw-addrmethod=CODE
        VAR_CLEARED_QM_GLOBAL_UNSPECIFIED: sw-addrmethod=VAR_CLEARED
        CONFIG_DATA_QM_GLOBAL_UNSPECIFIED: sw-addrmethod=CONFIG_DATA
        VAR_CLEARED_QM_CORE0_UNSPECIFIED: sw-addrmethod=VAR_CLEARED
        CONFIG_DATA_QM_CORE0_UNSPECIFIED: sw-addrmethod=CONFIG_DATA
        CONST_QM_CORE0_UNSPECIFIED: sw-addrmethod=CONFIG_DATA
      section name prefix LIN_17_ASCLIN
package /AUTOSAR_Lin_17_AscLin/ImplementationDataTypes
  4 x impl type, all with category=STRUCTURE, type-emitter=BSW:
    Lin_17_AscLin_ChannelTimingConfigType
      6 x element, all with category=TYPE_REFERENCE:
        HwBrgNumerator: implementation-data-type=uint16
        HwBrgDenominator: implementation-data-type=uint16
        HwBitconPrescalar: implementation-data-type=uint16
        HwWakeupBitconPrescalar: implementation-data-type=uint16
        InterByteResponseSpace: implementation-data-type=uint8
        HwWakeupIocrDepth: implementation-data-type=uint8
    Lin_17_AscLin_ChannelType
      7 x element, all with category=TYPE_REFERENCE:
        TimingConfig: implementation-data-type=Lin_17_AscLin_ChannelTimingConfigType
        WakeupSourceId: implementation-data-type=EcuM_WakeupSourceType
        HwModule: implementation-data-type=uint8
        Wakeup: implementation-data-type=uint8
        RxAlternatePinSelect: implementation-data-type=uint8
        LogicalId: implementation-data-type=uint8
        NodeType: implementation-data-type=uint8
    Lin_17_AscLin_CoreConfigType
      element MaxCoreChannels: implementation-data-type=uint8
      element ChannelConfigPtr: category=DATA_REFERENCE, sw-pointer-target-props={target-category=TYPE_REFERENCE, implementation-data-type=Lin_17_AscLin_ChannelType}
    Lin_17_AscLin_ConfigType
      element CoreConfigPtr: category=DATA_REFERENCE, array-size=3, array-size-semantics=FIXED-SIZE, sw-pointer-target-props={target-category=TYPE_REFERENCE, implementation-data-type=Lin_17_AscLin_CoreConfigType}
      element ChannelToCorePtr: implementation-data-type=uint8
      element Lin_17_AscLin_ChannelIdLookupPtr: implementation-data-type=uint8
