AUTOSAR XML (schema 4-2-2)
# Copyright (C) Infineon Technologies (2020)
# All rights reserved.
package /AURIX2G_Stm/BswModuleDescriptions
  bsw module description Stm: category=BSW_MODULE, module-id=255  # STM Driver
    provided-entrys:
      Stm_EnableModule
      Stm_EnableAlarm
      Stm_DisableAlarm
      Stm_SetCompareMatchControl
      Stm_ReadTimerValue
      Stm_ReadTotalTimerValue
      Stm_SleepModeHandle
      Stm_Isr
    bsw module dependency DetDependency: target-module-id=15, required-entrys=Det_ReportError
    bsw module dependency McuDependency: target-module-id=101, required-entrys=Mcu_17_Stm_CompareMatchIsr
    bsw module dependency McalLibDependency: target-module-id=255, required-entrys=[Mcal_WritePeripEndInitProtReg, Mcal_GetCpuIndex, Mcal_GetBitAtomic, Mcal_SetBitAtomic]
    bsw internal behavior StmBehavior
      7 x bsw called entity:
        Stm_EnableModule: reentrancy-level=NON-REENTRANT, implemented-entry=Stm_EnableModule
        Stm_EnableAlarm: reentrancy-level=MULTICORE-REENTRANT, implemented-entry=Stm_EnableAlarm
        Stm_DisableAlarm: reentrancy-level=MULTICORE-REENTRANT, implemented-entry=Stm_DisableAlarm
        Stm_SetCompareMatchControl: reentrancy-level=MULTICORE-REENTRANT, implemented-entry=Stm_SetCompareMatchControl
        Stm_ReadTimerValue: reentrancy-level=MULTICORE-REENTRANT, implemented-entry=Stm_ReadTimerValue
        Stm_ReadTotalTimerValue: reentrancy-level=MULTICORE-REENTRANT, implemented-entry=Stm_ReadTotalTimerValue
        Stm_SleepModeHandle: reentrancy-level=NON-REENTRANT, implemented-entry=Stm_SleepModeHandle
      bsw interrupt entity Stm_Isr: reentrancy-level=MULTICORE-REENTRANT, implemented-entry=Stm_Isr
      service-needs:
        diagnostic event needs STM_E_CLC_ENABLE_ERR
package /AURIX2G_Stm/BswModuleEntrys
  8 x bsw module entry, all with is-synchronous=true, sw-service-impl-policy=STANDARD:
    Stm_EnableModule: service-id=199, is-reentrant=false, call-type=REGULAR, execution-context=TASK
      sw service arg ModuleNumber: implementation-data-type=uint8
    Stm_EnableAlarm: service-id=200, is-reentrant=true, call-type=REGULAR, execution-context=TASK
      5 x sw service arg, all with category=TYPE_REFERENCE:
        ModuleNumber: implementation-data-type=uint8
        CompareRegisterId: implementation-data-type=uint8
        TimerMode: implementation-data-type=uint8
        Ticks: implementation-data-type=uint32
        Stm_Applicationfunction: implementation-data-type=Stm_CallbackFnPtrType
    Stm_DisableAlarm: service-id=201, is-reentrant=true, call-type=REGULAR, execution-context=TASK
      sw service arg ModuleNumber: implementation-data-type=uint8
      sw service arg CompareRegisterId: implementation-data-type=uint8
    Stm_SetCompareMatchControl: service-id=202, is-reentrant=true, call-type=REGULAR, execution-context=TASK
      4 x sw service arg, all with category=TYPE_REFERENCE, implementation-data-type=uint8:
        ModuleNumber
        CompareRegisterId
        Mstart
        MSize
    Stm_ReadTimerValue: service-id=203, is-reentrant=true, call-type=REGULAR, execution-context=TASK
      return type Return: implementation-data-type=uint32
      sw service arg ModuleNumber: implementation-data-type=uint8
      sw service arg TimerNumber: implementation-data-type=uint8
    Stm_ReadTotalTimerValue: service-id=204, is-reentrant=true, call-type=REGULAR, execution-context=TASK
      return type Return: implementation-data-type=Stm_TotalTimerCaptureType
      sw service arg ModuleNumber: implementation-data-type=uint8
    Stm_SleepModeHandle: service-id=205, is-reentrant=false, call-type=REGULAR, execution-context=TASK
      sw service arg ModuleNumber: implementation-data-type=uint8
      sw service arg SleepmodeControl: implementation-data-type=uint8
    Stm_Isr: is-reentrant=true, call-type=INTERRUPT, execution-context=INTERRUPT-CAT-1
      sw service arg ModuleNumber: implementation-data-type=uint8
      sw service arg InterruptNode: implementation-data-type=uint32
package /AURIX2G_Stm/Implementations
  bsw implementation Stm: programming-language=C, sw-version=10.40.0, vendor-id=17, ar-release-version=4.2.2, behavior=StmBehavior, vendor-specific-module-def=Stm
    code-descriptors:
      code Files: artifact-descriptors=[{short-label=ssc::src::Stm.c, category=SWSRC}, {short-label=ssc::inc::Stm.h, category=SWHDR}]
    generated-artifacts:
      dependency on artifact Stm_Cfg_c: artifact-descriptor={short-label=generate::template::src::Stm_Cfg.c, category=SWTEMPLATE}, usages=COMPILE
      dependency on artifact Stm_Cfg_h: artifact-descriptor={short-label=generate::template::inc::Stm_Cfg.h, category=SWTEMPLATE}, usages=COMPILE
      dependency on artifact Stm_bmd: artifact-descriptor={short-label=autosar::TC37x::TC377x::Stm.bmd, category=SWTOOL}, usages=CODEGENERATION
    resource consumption ResourceConsumption
      8 x memory section, all with alignment=UNSPECIFIED:
        VAR_CLEARED_QM_CORE{0..2}_UNSPECIFIED: sw-addrmethod=VAR_CLEARED
        CODE_QM_GLOBAL: sw-addrmethod=CODE
        CONFIG_DATA_QM_GLOBAL_UNSPECIFIED: sw-addrmethod=CONFIG_DATA
        CODE_FAST_QM_GLOBAL: sw-addrmethod=CODE_FAST
        CONST_QM_GLOBAL_UNSPECIFIED: sw-addrmethod=CONST
        VAR_INIT_QM_GLOBAL_UNSPECIFIED: sw-addrmethod=VAR_INIT
      section name prefix STM
package /AURIX2G_Stm/ImplementationDataTypes
  impl type Stm_CallbackFnPtrType: category=FUNCTION_REFERENCE, sw-pointer-target-props=Stm_AppCallBack, type-emitter=BSW
  impl type Stm_TotalTimerCaptureType: category=STRUCTURE, type-emitter=BSW
    element LowerPart: implementation-data-type=uint32
    element UpperPart: implementation-data-type=uint32
