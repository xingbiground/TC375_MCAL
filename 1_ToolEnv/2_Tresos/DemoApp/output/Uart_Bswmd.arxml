AUTOSAR XML (schema 4-2-2)
# Copyright (C) Infineon Technologies (2023)
# All rights reserved.
package /AURIX2G_Uart/BswModuleDescriptions
  bsw module description Uart: category=BSW_MODULE, module-id=255  # Universal Asynchronous Reciever Transmitter Driver
    provided-entrys:
      Uart_Init
      Uart_DeInit
      Uart_Read
      Uart_Write
      Uart_AbortRead
      Uart_StartStreaming
      Uart_StopStreaming
      Uart_AbortWrite
      Uart_GetStatus
      Uart_GetVersionInfo
      Uart_MainFunction_Read
      Uart_MainFunction_Write
    4 x bsw module dependency:
      DetDependency: target-module-id=15, required-entrys=Det_ReportError
      McalWrapperDependency: target-module-id=255, required-entrys=Mcal_Wrapper_Det_ReportRuntimeError
      McalSafetyErrorDependency: target-module-id=255, required-entrys=Mcal_ReportSafetyError
      McalLibDependency: target-module-id=255, required-entrys=[Mcal_WritePeripEndInitProtReg, Mcal_DelayTickResolution, Mcal_DelayGetTick]
    bsw internal behavior UartBehavior
      10 x bsw called entity:
        Uart_Init: reentrancy-level=NON-REENTRANT, implemented-entry=Uart_Init
        Uart_DeInit: reentrancy-level=NON-REENTRANT, implemented-entry=Uart_DeInit
        Uart_Read: reentrancy-level=SINGLE-CORE-REENTRANT, implemented-entry=Uart_Read
        Uart_Write: reentrancy-level=SINGLE-CORE-REENTRANT, implemented-entry=Uart_Write
        Uart_AbortRead: reentrancy-level=SINGLE-CORE-REENTRANT, implemented-entry=Uart_AbortRead
        Uart_StartStreaming: reentrancy-level=SINGLE-CORE-REENTRANT, implemented-entry=Uart_StartStreaming
        Uart_StopStreaming: reentrancy-level=SINGLE-CORE-REENTRANT, implemented-entry=Uart_StopStreaming
        Uart_AbortWrite: reentrancy-level=SINGLE-CORE-REENTRANT, implemented-entry=Uart_AbortWrite
        Uart_GetStatus: reentrancy-level=SINGLE-CORE-REENTRANT, implemented-entry=Uart_GetStatus
        Uart_GetVersionInfo: reentrancy-level=SINGLE-CORE-REENTRANT, implemented-entry=Uart_GetVersionInfo
      bsw schedulable entity Uart_MainFunction_Read: minimum-start-interval=0.005, reentrancy-level=NON-REENTRANT, implemented-entry=Uart_MainFunction_Read
      bsw schedulable entity Uart_MainFunction_Write: minimum-start-interval=0.005, reentrancy-level=NON-REENTRANT, implemented-entry=Uart_MainFunction_Write
package /AURIX2G_Uart/BswModuleEntrys
  12 x bsw module entry, all with execution-context=TASK, sw-service-impl-policy=STANDARD:
    Uart_Init: service-id=215, is-reentrant=false, is-synchronous=true, call-type=REGULAR
      sw service arg ConfigPtr: category=DATA_REFERENCE, sw-pointer-target-props={target-category=TYPE_REFERENCE, implementation-data-type=Uart_ConfigType}
    Uart_DeInit: service-id=222, is-reentrant=false, is-synchronous=true, call-type=REGULAR
    Uart_Read: service-id=217, is-reentrant=true, is-synchronous=false, call-type=REGULAR
      return type Return: implementation-data-type=Uart_ReturnType
      sw service arg Channel: implementation-data-type=Uart_ChannelIdType
      sw service arg MemPtr: category=DATA_REFERENCE, sw-pointer-target-props={target-category=TYPE_REFERENCE, implementation-data-type=Uart_MemType}
      sw service arg Size: implementation-data-type=Uart_SizeType
    Uart_StartStreaming: service-id=229, is-reentrant=true, is-synchronous=false, call-type=REGULAR
      return type Return: implementation-data-type=Uart_ReturnType
      sw service arg Channel: implementation-data-type=Uart_ChannelIdType
      sw service arg MemPtr: category=DATA_REFERENCE, sw-pointer-target-props={target-category=TYPE_REFERENCE, implementation-data-type=Uart_MemType}
      sw service arg BufSize: implementation-data-type=Uart_SizeType
    Uart_Write: service-id=218, is-reentrant=true, is-synchronous=false, call-type=REGULAR
      return type Return: implementation-data-type=Uart_ReturnType
      sw service arg Channel: implementation-data-type=Uart_ChannelIdType
      sw service arg MemPtr: category=DATA_REFERENCE, sw-pointer-target-props={target-category=TYPE_REFERENCE, implementation-data-type=Uart_MemType}
      sw service arg Size: implementation-data-type=Uart_SizeType
    Uart_AbortRead: service-id=220, is-reentrant=true, is-synchronous=true, call-type=REGULAR
      return type Return: implementation-data-type=Uart_SizeType
      sw service arg Channel: implementation-data-type=Uart_ChannelIdType
    Uart_StopStreaming: service-id=230, is-reentrant=true, is-synchronous=true, call-type=REGULAR
      return type Return: implementation-data-type=Uart_ReturnType
      sw service arg Channel: implementation-data-type=Uart_ChannelIdType
    Uart_AbortWrite: service-id=219, is-reentrant=true, is-synchronous=true, call-type=REGULAR
      return type Return: implementation-data-type=Uart_SizeType
      sw service arg Channel: implementation-data-type=Uart_ChannelIdType
    Uart_GetStatus: service-id=221, is-reentrant=true, is-synchronous=true, call-type=REGULAR
      return type Return: implementation-data-type=Uart_StatusType
      sw service arg Channel: implementation-data-type=Uart_ChannelIdType
    Uart_GetVersionInfo: service-id=223, is-reentrant=true, is-synchronous=true, call-type=REGULAR
      sw service arg versioninfo: category=DATA_REFERENCE, sw-pointer-target-props={target-category=TYPE_REFERENCE, implementation-data-type=Std_VersionInfoType}
    Uart_MainFunction_Read: service-id=224, is-reentrant=false, is-synchronous=true, call-type=SCHEDULED
    Uart_MainFunction_Write: service-id=225, is-reentrant=false, is-synchronous=true, call-type=SCHEDULED
package /AURIX2G_Uart/Implementations
  bsw implementation Uart: programming-language=C, sw-version=20.25.0, vendor-id=17, ar-release-version=4.2.2, behavior=UartBehavior, vendor-specific-module-def=Uart
    code-descriptors:
      code Files: artifact-descriptors=[{short-label=ssc::src::Uart.c, category=SWSRC}, {short-label=ssc::inc::Uart.h, category=SWHDR}]
    generated-artifacts:
      5 x dependency on artifact:
        Uart_Cfg_h: artifact-descriptor={short-label=generate::inc::Uart_Cfg.h, category=SWTEMPLATE}, usages=COMPILE
        Uart_PBcfg_h: artifact-descriptor={short-label=generate::inc::Uart_PBcfg.h, category=SWTEMPLATE}, usages=EXECUTE
        Uart_PBcfg_c: artifact-descriptor={short-label=generate::src::Uart_PBcfg.c, category=SWTEMPLATE}, usages=EXECUTE
        Uart_xdm: artifact-descriptor={short-label=config::Uart.xdm, category=SWTOOL}, usages=CODEGENERATION
        Uart_bmd: artifact-descriptor={short-label=autosar::TC37x::TC375x::Uart.bmd, category=SWTOOL}, usages=CODEGENERATION
    resource consumption ResourceConsumption
      7 x memory section:
        VAR_CLEARED_ASIL_B_LOCAL_8: alignment=8, sw-addrmethod=VAR_CLEARED
        VAR_CLEARED_ASIL_B_LOCAL_32: alignment=32, sw-addrmethod=VAR_CLEARED
        VAR_CLEARED_ASIL_B_LOCAL_UNSPECIFIED: alignment=UNSPECIFIED, sw-addrmethod=VAR_CLEARED
        CODE_ASIL_B_LOCAL: alignment=UNSPECIFIED, sw-addrmethod=CODE
        CONST_ASIL_B_16: alignment=16, sw-addrmethod=CONST
        CONST_ASIL_B_LOCAL_32: alignment=32, sw-addrmethod=CONST
        CONFIG_DATA_ASIL_B_LOCAL_UNSPECIFIED: alignment=UNSPECIFIED, sw-addrmethod=CONFIG_DATA
      section name prefix UART
package /AURIX2G_Uart/ImplementationDataTypes
  11 x impl type, all with type-emitter=BSW:
    Uart_ChannelIdType: implementation-data-type=uint8
    Uart_ErrorIdType: compu {0=UART_NO_ERR, 1=UART_PARITY_ERR, 2=UART_FRAME_ERR, 3=UART_RXOVERFLOW_ERR}, implementation-data-type=sint32, additional-native-type-qualifier=enum
    Uart_MemType: implementation-data-type=uint8
    Uart_NotificationPtrType: category=FUNCTION_REFERENCE, sw-pointer-target-props=UartNotificationCallback
    Uart_Streaming_NotificationPtrType: category=FUNCTION_REFERENCE, sw-pointer-target-props=UartNotificationCallback
    Uart_ReturnType: compu {0=UART_OK, 1=UART_NOT_OK, 2=UART_IS_BUSY}, implementation-data-type=sint32, additional-native-type-qualifier=enum
    Uart_SizeType: implementation-data-type=uint16
    Uart_StatusType: compu {0=UART_IDLE, 1=UART_BUSY_TRANSMIT, 2=UART_BUSY_RECEIVE, 3=UART_BUSY_TRANSMIT_RECEIVE}, implementation-data-type=sint32, additional-native-type-qualifier=enum
    UartNotifType: category=STRUCTURE
      5 x element, all with category=DATA_REFERENCE:
        UartTransmitNotifPtr: sw-pointer-target-props={target-category=TYPE_REFERENCE, implementation-data-type=Uart_NotificationPtrType}
        UartReceiveNotifPtr: sw-pointer-target-props={target-category=TYPE_REFERENCE, implementation-data-type=Uart_NotificationPtrType}
        UartAbortTransmitNotifPtr: sw-pointer-target-props={target-category=TYPE_REFERENCE, implementation-data-type=Uart_NotificationPtrType}
        UartAbortReceiveNotifPtr: sw-pointer-target-props={target-category=TYPE_REFERENCE, implementation-data-type=Uart_NotificationPtrType}
        UartStreamingRecvNotifPtr: sw-pointer-target-props={target-category=TYPE_REFERENCE, implementation-data-type=Uart_Streaming_NotificationPtrType}
    Uart_ChannelConfigType: category=STRUCTURE
      16 x element, all with category=TYPE_REFERENCE:
        UartNotif: implementation-data-type=UartNotifType
        BaudRateNumerator: implementation-data-type=uint16
        BaudrateDenominator: implementation-data-type=uint16
        BaudratePrescalar: implementation-data-type=uint16
        HwBaudOversampling: implementation-data-type=uint8
        HwModule: implementation-data-type=uint8
        StopBits: implementation-data-type=uint8
        DataLength: implementation-data-type=uint8
        RxPin: implementation-data-type=uint8
        ParityEnable: implementation-data-type=uint8
        Parity: implementation-data-type=uint8
        CTSPin: implementation-data-type=uint8
        CtsEnable: implementation-data-type=uint8
        CtsPolarity: implementation-data-type=uint8
        UartRxMode: implementation-data-type=uint8
        UartTxMode: implementation-data-type=uint8
    Uart_ConfigType: category=STRUCTURE
      element ChannelConfigPtr: category=DATA_REFERENCE, sw-pointer-target-props={target-category=TYPE_REFERENCE, implementation-data-type=Uart_ChannelConfigType}
      element Uart_ChannelIdLookupPtr: category=DATA_REFERENCE, sw-pointer-target-props={target-category=TYPE_REFERENCE, implementation-data-type=uint8}
      element NoOfChannels: implementation-data-type=uint8
