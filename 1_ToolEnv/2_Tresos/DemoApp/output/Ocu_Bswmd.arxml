AUTOSAR XML (schema 4-2-2)
# Copyright (C) Infineon Technologies (2021)
# All rights reserved.
package /AUTOSAR_Ocu/BswModuleDescriptions
  bsw module description Ocu: category=BSW_MODULE, module-id=125  # OCU Driver
    provided-entrys:
      Ocu_Init
      Ocu_StartChannel
      Ocu_StopChannel
      Ocu_DeInit
      Ocu_InitCheck
      Ocu_SetPinAction
      Ocu_SetPinState
      Ocu_GetCounter
      Ocu_SetAbsoluteThreshold
      Ocu_SetRelativeThreshold
      Ocu_Timer_Isr
      Ocu_EnableNotification
      Ocu_DisableNotification
    4 x bsw module dependency:
      DetDependency: target-module-id=15, required-entrys=Det_ReportError
      McuDependency: target-module-id=101
        required-entrys:
          Mcu_17_Gtm_AtomChEndisCtrlUpdate
          Mcu_17_Gtm_AtomChEndisStatUpdate
          Mcu_17_Gtm_AtomChInitCheck
          Mcu_17_Gtm_AtomChOutEnCtrlUpdate
          Mcu_17_Gtm_AtomChOutEnStatUpdate
          Mcu_17_Gtm_AtomChUpdateEnDis
          Mcu_17_Gtm_AtomChannelDeInit
          Mcu_17_Gtm_AtomChannelDisable
          Mcu_17_Gtm_AtomChannelEnable
          Mcu_17_Gtm_AtomChannelInit
          Mcu_17_Gtm_AtomChannelShadowTransfer
          Mcu_17_Gtm_TomChInitCheck
          Mcu_17_Gtm_TomChUpdateEnDis
          Mcu_17_Gtm_TomChannelDeInit
          Mcu_17_Gtm_TomChannelDisable
          Mcu_17_Gtm_TomChannelEnable
          Mcu_17_Gtm_TomChannelInit
          Mcu_17_Gtm_TomChannelShadowTransfer
      McalLibDependency: target-module-id=255, required-entrys=[Mcal_GetCpuIndex, Mcal_GetBitAtomic, Mcal_SetBitAtomic]
      McalSafetyErrorDependency: target-module-id=255, required-entrys=Mcal_ReportSafetyError
    bsw internal behavior OcuBehavior
      12 x bsw called entity:
        Ocu_Init: reentrancy-level=NON-REENTRANT, implemented-entry=Ocu_Init
        Ocu_DeInit: reentrancy-level=NON-REENTRANT, implemented-entry=Ocu_DeInit
        Ocu_DisableNotification: reentrancy-level=MULTICORE-REENTRANT, implemented-entry=Ocu_DisableNotification
        Ocu_EnableNotification: reentrancy-level=MULTICORE-REENTRANT, implemented-entry=Ocu_EnableNotification
        Ocu_GetCounter: reentrancy-level=MULTICORE-REENTRANT, implemented-entry=Ocu_GetCounter
        Ocu_StartChannel: reentrancy-level=MULTICORE-REENTRANT, implemented-entry=Ocu_StartChannel
        Ocu_StopChannel: reentrancy-level=MULTICORE-REENTRANT, implemented-entry=Ocu_StopChannel
        Ocu_SetAbsoluteThreshold: reentrancy-level=MULTICORE-REENTRANT, implemented-entry=Ocu_SetAbsoluteThreshold
        Ocu_SetRelativeThreshold: reentrancy-level=MULTICORE-REENTRANT, implemented-entry=Ocu_SetRelativeThreshold
        Ocu_SetPinAction: reentrancy-level=MULTICORE-REENTRANT, implemented-entry=Ocu_SetPinAction
        Ocu_SetPinState: reentrancy-level=MULTICORE-REENTRANT, implemented-entry=Ocu_SetPinState
        Ocu_InitCheck: reentrancy-level=NON-REENTRANT, implemented-entry=Ocu_InitCheck
      bsw interrupt entity Ocu_Timer_Isr: reentrancy-level=MULTICORE-REENTRANT, implemented-entry=Ocu_Timer_Isr
package /AUTOSAR_Ocu/BswModuleEntrys
  13 x bsw module entry, all with is-synchronous=true, sw-service-impl-policy=STANDARD:
    Ocu_Init: service-id=0, is-reentrant=false, call-type=REGULAR, execution-context=TASK
      sw service arg ConfigPtr: category=DATA_REFERENCE, sw-pointer-target-props={target-category=TYPE_REFERENCE, implementation-data-type=Ocu_ConfigType}
    Ocu_InitCheck: service-id=12, is-reentrant=false, call-type=REGULAR, execution-context=TASK
      return type Return: implementation-data-type=Std_ReturnType
      sw service arg ConfigPtr: category=DATA_REFERENCE, sw-pointer-target-props={target-category=TYPE_REFERENCE, implementation-data-type=Ocu_ConfigType}
    Ocu_DeInit: service-id=1, is-reentrant=false, call-type=REGULAR, execution-context=TASK
    Ocu_DisableNotification: service-id=10, is-reentrant=true, call-type=REGULAR, execution-context=TASK
      sw service arg ChannelNumber: implementation-data-type=Ocu_ChannelType
    Ocu_EnableNotification: service-id=11, is-reentrant=true, call-type=REGULAR, execution-context=TASK
      sw service arg ChannelNumber: implementation-data-type=Ocu_ChannelType
    Ocu_StartChannel: service-id=2, is-reentrant=true, call-type=REGULAR, execution-context=TASK
      sw service arg ChannelNumber: implementation-data-type=Ocu_ChannelType
    Ocu_StopChannel: service-id=3, is-reentrant=true, call-type=REGULAR, execution-context=TASK
      sw service arg ChannelNumber: implementation-data-type=Ocu_ChannelType
    Ocu_GetCounter: service-id=6, is-reentrant=true, call-type=REGULAR, execution-context=TASK
      return type Return: implementation-data-type=Ocu_ValueType
      sw service arg ChannelNumber: implementation-data-type=Ocu_ChannelType
    Ocu_SetPinAction: service-id=5, is-reentrant=true, call-type=REGULAR, execution-context=TASK
      sw service arg ChannelNumber: implementation-data-type=Ocu_ChannelType
      sw service arg PinAction: implementation-data-type=Ocu_PinActionType
    Ocu_SetPinState: service-id=4, is-reentrant=true, call-type=REGULAR, execution-context=TASK
      sw service arg ChannelNumber: implementation-data-type=Ocu_ChannelType
      sw service arg PinState: implementation-data-type=Ocu_PinStateType
    Ocu_SetAbsoluteThreshold: service-id=7, is-reentrant=true, call-type=REGULAR, execution-context=TASK
      return type Return: implementation-data-type=Ocu_ReturnType
      sw service arg ChannelNumber: implementation-data-type=Ocu_ChannelType
      sw service arg ReferenceValue: implementation-data-type=Ocu_ValueType
      sw service arg AbsoluteValue: implementation-data-type=Ocu_ValueType
    Ocu_SetRelativeThreshold: service-id=8, is-reentrant=true, call-type=REGULAR, execution-context=TASK
      return type Return: implementation-data-type=Ocu_ReturnType
      sw service arg ChannelNumber: implementation-data-type=Ocu_ChannelType
      sw service arg RelativeValue: implementation-data-type=Ocu_ValueType
    Ocu_Timer_Isr: service-id=32, is-reentrant=true, call-type=CALLBACK, execution-context=INTERRUPT-CAT-1
      sw service arg Channel: implementation-data-type=uint8
package /AUTOSAR_Ocu/Implementations
  bsw implementation Ocu: programming-language=C, sw-version=20.10.0, vendor-id=17, ar-release-version=4.2.2, behavior=OcuBehavior, vendor-specific-module-def=Ocu
    code-descriptors:
      code Files
        artifact-descriptors:
          short-label=ssc::src::Ocu.c, category=SWSRC
          short-label=ssc::inc::Ocu.h, category=SWHDR
          short-label=ssc::inc::Ocu_Local.h, category=SWHDR
          short-label=ssc::inc::Ocu_Cbk.h, category=SWHDR
    generated-artifacts:
      5 x dependency on artifact, all with usages=CODEGENERATION:
        Ocu_PBcfg_c: artifact-descriptor={short-label=generate::template::src::Ocu_PBcfg.c, category=SWSRC}
        Ocu_PBcfg_h: artifact-descriptor={short-label=generate::template::inc::Ocu_PBcfg.h, category=SWHDR}
        Ocu_Cfg_h: artifact-descriptor={short-label=generate::template::inc::Ocu_Cfg.h, category=SWHDR}
        Ocu_xdm: artifact-descriptor={short-label=config::Ocu.xdm, category=SWTOOL}
        Ocu_bmd: artifact-descriptor={short-label=autosar::TC37x::TC377x::Ocu.bmd, category=SWTOOL}
    resource consumption ResourceConsumption
      6 x memory section:
        VAR_CLEARED_ASIL_B_CORE0_32: alignment=32, sw-addrmethod=VAR_CLEARED
        CONFIG_DATA_ASIL_B_CORE0_UNSPECIFIED: alignment=UNSPECIFIED, sw-addrmethod=CONFIG_DATA
        CONST_ASIL_B_GLOBAL_32: alignment=32, sw-addrmethod=CONST
        VAR_CLEARED_ASIL_B_GLOBAL_32: alignment=32, sw-addrmethod=VAR_CLEARED
        CONFIG_DATA_ASIL_B_GLOBAL_UNSPECIFIED: alignment=UNSPECIFIED, sw-addrmethod=CONFIG_DATA
        CODE_ASIL_B_GLOBAL: alignment=UNSPECIFIED, sw-addrmethod=CODE
      section name prefix OCU
package /AUTOSAR_Ocu/ImplementationDataTypes
  10 x impl type, all with type-emitter=BSW:
    Ocu_NotifiPtrType: category=FUNCTION_REFERENCE, sw-pointer-target-props=IoHwAb_OcuNotification
    Ocu_PinActionType: compu {0=OCU_DISABLE, 1=OCU_SET_HIGH, 2=OCU_SET_LOW, 3=OCU_TOGGLE}, implementation-data-type=sint32, additional-native-type-qualifier=enum
    Ocu_ChannelType: implementation-data-type=uint8
    Ocu_ReturnType: compu {1=OCU_CM_IN_REF_INTERVAL, 0=OCU_CM_OUT_REF_INTERVAL}, implementation-data-type=sint32, additional-native-type-qualifier=enum
    Ocu_ValueType: implementation-data-type=uint32
    Ocu_PinStateType: compu {0=OCU_LOW, 1=OCU_HIGH}, implementation-data-type=sint32, additional-native-type-qualifier=enum
    Ocu_ChannelConfigType: category=STRUCTURE
    Ocu_ChannelConfigType: category=STRUCTURE
      11 x element, all with category=TYPE_REFERENCE:
        NotificationPointer: implementation-data-type=Ocu_NotifiPtrType
        DefaultThreshold: implementation-data-type=Ocu_ValueType
        MaxCounterValue: implementation-data-type=Ocu_ValueType
        AssignedHwUnit: sw-bit-representation=number-of-bits=2, implementation-data-type=unsigned_int
        AssignedHwUnitNumber: sw-bit-representation=number-of-bits=16, implementation-data-type=unsigned_int
        PinDefaultState: sw-bit-representation=number-of-bits=1, implementation-data-type=unsigned_int
        PinUsed: sw-bit-representation=number-of-bits=1, implementation-data-type=unsigned_int
        DmaUsed: sw-bit-representation=number-of-bits=1, implementation-data-type=unsigned_int
        AdcUsed: sw-bit-representation=number-of-bits=1, implementation-data-type=unsigned_int
        ClockSelect: sw-bit-representation=number-of-bits=4, implementation-data-type=unsigned_int
        Reserved: sw-bit-representation=number-of-bits=6, implementation-data-type=unsigned_int
    Ocu_CoreConfigType: category=STRUCTURE
      element ChannelConfigPtr: category=DATA_REFERENCE, sw-pointer-target-props={target-category=TYPE_REFERENCE, implementation-data-type=ImplementationDataTypes/Ocu_ChannelConfigType}
      element MaxChannelCore: implementation-data-type=Ocu_ChannelType
    Ocu_ConfigType: category=STRUCTURE
      element CoreConfig: category=DATA_REFERENCE, array-size=6, array-size-semantics=FIXED-SIZE, sw-pointer-target-props={target-category=TYPE_REFERENCE, implementation-data-type=Ocu_CoreConfigType}
