AUTOSAR XML (schema 4-2-2)
# Copyright (C) Infineon Technologies (2023)
# All rights reserved.
package /AUTOSAR_Eth_17_GEthMac/BswModuleDescriptions
  bsw module description Eth: category=BSW_MODULE, module-id=88  # ETH Driver
    provided-entrys:
      Eth_Init
      Eth_SetControllerMode
      Eth_GetControllerMode
      Eth_GetPhysAddr
      Eth_SetPhysAddr
      Eth_WriteMii
      Eth_ReadMii
      Eth_ProvideTxBuffer
      Eth_Transmit
      Eth_Receive
      Eth_TxConfirmation
      Eth_RxDmaCh0IrqHdlr
      Eth_TxDmaCh0IrqHdlr
      Eth_GetVersionInfo
      Eth_UpdatePhysAddrFilter
      Eth_GetDropCount
      Eth_GetEtherStats
      Eth_GetCurrentTime
      Eth_EnableEgressTimeStamp
      Eth_GetEgressTimeStamp
      Eth_GetIngressTimeStamp
      Eth_SetCorrectionTime
      Eth_SetGlobalTime
      Eth_MainFunction
    bsw module dependency EthIfDependency: target-module-id=65, required-entrys=[EthIf_CtrlModeIndication, EthIf_RxIndication, EthIf_TxConfirmation]
    bsw module dependency EthTrcvDependency: target-module-id=73, required-entrys=[EthTrcv_WriteMiiIndication, EthTrcv_ReadMiiIndication]
    bsw module dependency McalLibDependency: target-module-id=255, required-entrys=[Mcal_WritePeripEndInitProtReg, Mcal_DelayTickResolution, Mcal_DelayGetTick]
    bsw internal behavior EthBehavior
      exclusive area UpdateGlobalTime
      exclusive area TransmitData
      12 x bsw called entity:
        Eth_Init: reentrancy-level=NON-REENTRANT, implemented-entry=Eth_Init
        Eth_SetControllerMode: reentrancy-level=NON-REENTRANT, implemented-entry=Eth_SetControllerMode
        Eth_GetControllerMode: reentrancy-level=NON-REENTRANT, implemented-entry=Eth_GetControllerMode
        Eth_GetPhysAddr: reentrancy-level=NON-REENTRANT, implemented-entry=Eth_GetPhysAddr
        Eth_SetPhysAddr: reentrancy-level=NON-REENTRANT, implemented-entry=Eth_SetPhysAddr
        Eth_WriteMii: reentrancy-level=NON-REENTRANT, implemented-entry=Eth_WriteMii
        Eth_ReadMii: reentrancy-level=NON-REENTRANT, implemented-entry=Eth_ReadMii
        Eth_Receive: reentrancy-level=NON-REENTRANT, implemented-entry=Eth_Receive
        Eth_TxConfirmation: reentrancy-level=NON-REENTRANT, implemented-entry=Eth_TxConfirmation
        Eth_Transmit: can-enter-exclusive-area=TransmitData, reentrancy-level=NON-REENTRANT, implemented-entry=Eth_Transmit
        Eth_ProvideTxBuffer: can-enter-exclusive-area=TransmitData, reentrancy-level=NON-REENTRANT, implemented-entry=Eth_ProvideTxBuffer
        Eth_GetVersionInfo: reentrancy-level=SINGLE-CORE-REENTRANT, implemented-entry=Eth_GetVersionInfo
      bsw interrupt entity Eth_RxDmaCh0IrqHdlr: reentrancy-level=NON-REENTRANT, implemented-entry=Eth_RxDmaCh0IrqHdlr
      bsw interrupt entity Eth_TxDmaCh0IrqHdlr: reentrancy-level=NON-REENTRANT, implemented-entry=Eth_TxDmaCh0IrqHdlr
      10 x bsw called entity, all with reentrancy-level=NON-REENTRANT:
        Eth_UpdatePhysAddrFilter: implemented-entry=Eth_UpdatePhysAddrFilter
        Eth_GetDropCount: implemented-entry=Eth_GetDropCount
        Eth_GetEtherStats: implemented-entry=Eth_GetEtherStats
        Eth_GetCurrentTime: implemented-entry=Eth_GetCurrentTime
        Eth_EnableEgressTimeStamp: implemented-entry=Eth_EnableEgressTimeStamp
        Eth_GetEgressTimeStamp: implemented-entry=Eth_GetEgressTimeStamp
        Eth_GetIngressTimeStamp: implemented-entry=Eth_GetIngressTimeStamp
        Eth_SetCorrectionTime: can-enter-exclusive-area=UpdateGlobalTime, implemented-entry=Eth_SetCorrectionTime
        Eth_SetGlobalTime: can-enter-exclusive-area=UpdateGlobalTime, implemented-entry=Eth_SetGlobalTime
        Eth_MainFunction: minimum-start-interval=0.005, implemented-entry=Eth_MainFunction
      bsw timing event TimingEvent_Eth_MainFunction: starts-on-event=Eth_MainFunction, period=0.001
      service-needs:
        diagnostic event needs ETH_E_ACCESS
      service-needs:
        diagnostic event needs ETH_E_RX_FRAMES_LOST
      service-needs:
        diagnostic event needs ETH_E_CRC
      service-needs:
        diagnostic event needs ETH_E_UNDERSIZEFRAME
      service-needs:
        diagnostic event needs ETH_E_OVERSIZEFRAME
      service-needs:
        diagnostic event needs ETH_E_ALIGNMENT
      service-needs:
        diagnostic event needs ETH_E_SINGLECOLLISION
      service-needs:
        diagnostic event needs ETH_E_MULTIPLECOLLISION
      service-needs:
        diagnostic event needs ETH_E_LATECOLLISION
package /AUTOSAR_Eth_17_GEthMac/BswModuleEntrys
  24 x bsw module entry, all with is-synchronous=true:
    Eth_Init: service-id=1, is-reentrant=false, call-type=REGULAR, execution-context=TASK, sw-service-impl-policy=STANDARD
      sw service arg CfgPtr: category=DATA_REFERENCE, sw-pointer-target-props={target-category=TYPE_REFERENCE, implementation-data-type=Eth_17_GEthMac_ConfigType}
    Eth_SetControllerMode: service-id=3, is-reentrant=false, call-type=REGULAR, execution-context=TASK, sw-service-impl-policy=STANDARD
      return type Return: implementation-data-type=Std_ReturnType
      sw service arg CtrlIdx: implementation-data-type=uint8
      sw service arg CtrlMode: implementation-data-type=Eth_ModeType
    Eth_GetControllerMode: service-id=4, is-reentrant=false, call-type=REGULAR, execution-context=TASK, sw-service-impl-policy=STANDARD
      return type Return: implementation-data-type=Std_ReturnType
      sw service arg CtrlIdx: implementation-data-type=uint8
      sw service arg CtrlModePtr: category=DATA_REFERENCE, sw-pointer-target-props={target-category=TYPE_REFERENCE, implementation-data-type=Eth_ModeType}
    Eth_GetPhysAddr: service-id=8, is-reentrant=false, call-type=REGULAR, execution-context=TASK, sw-service-impl-policy=STANDARD
      sw service arg CtrlIdx: implementation-data-type=uint8
      sw service arg PhysAddrPtr: category=DATA_REFERENCE, sw-pointer-target-props={target-category=TYPE_REFERENCE, implementation-data-type=uint8}
    Eth_WriteMii: service-id=5, is-reentrant=false, call-type=REGULAR, execution-context=TASK, sw-service-impl-policy=STANDARD
      return type Return: implementation-data-type=Eth_ReturnType
      4 x sw service arg, all with category=TYPE_REFERENCE:
        CtrlIdx: implementation-data-type=uint8
        TrcvIdx: implementation-data-type=uint8
        RegIdx: implementation-data-type=uint8
        RegVal: implementation-data-type=uint16
    Eth_ReadMii: service-id=6, is-reentrant=false, call-type=REGULAR, execution-context=TASK, sw-service-impl-policy=STANDARD
      return type Return: implementation-data-type=Eth_ReturnType
      4 x sw service arg:
        CtrlIdx: implementation-data-type=uint8
        TrcvIdx: implementation-data-type=uint8
        RegIdx: implementation-data-type=uint8
        RegValPtr: category=DATA_REFERENCE, sw-pointer-target-props={target-category=TYPE_REFERENCE, implementation-data-type=uint16}
    Eth_ProvideTxBuffer: service-id=9, is-reentrant=false, call-type=REGULAR, execution-context=TASK, sw-service-impl-policy=STANDARD
      return type Return: implementation-data-type=BufReq_ReturnType
      4 x sw service arg:
        CtrlIdx: implementation-data-type=uint8
        BufIdxPtr: category=DATA_REFERENCE, sw-pointer-target-props={target-category=TYPE_REFERENCE, implementation-data-type=Eth_BufIdxType}
        BufPtr: category=DATA_REFERENCE, sw-pointer-target-props={target-category=TYPE_REFERENCE, implementation-data-type=uint8}
        LenBytePtr: category=DATA_REFERENCE, sw-pointer-target-props={target-category=TYPE_REFERENCE, implementation-data-type=uint16}
    Eth_Transmit: service-id=10, is-reentrant=false, call-type=REGULAR, execution-context=TASK, sw-service-impl-policy=STANDARD
      return type Return: implementation-data-type=Std_ReturnType
      6 x sw service arg:
        CtrlIdx: implementation-data-type=uint8
        BufIdx: implementation-data-type=Eth_BufIdxType
        FrameType: implementation-data-type=Eth_FrameType
        TxConfirmation: implementation-data-type=boolean
        LenByte: implementation-data-type=uint16
        PhysAddrPtr: category=DATA_REFERENCE, sw-pointer-target-props={target-category=TYPE_REFERENCE, implementation-data-type=uint8}
    Eth_Receive: service-id=11, is-reentrant=false, call-type=REGULAR, execution-context=TASK, sw-service-impl-policy=STANDARD
      sw service arg CtrlIdx: implementation-data-type=uint8
      sw service arg RxStatusPtr: category=DATA_REFERENCE, sw-pointer-target-props={target-category=TYPE_REFERENCE, implementation-data-type=Eth_RxStatusType}
    Eth_TxConfirmation: service-id=12, is-reentrant=false, call-type=REGULAR, execution-context=TASK, sw-service-impl-policy=STANDARD
      sw service arg CtrlIdx: implementation-data-type=uint8
    Eth_RxDmaCh0IrqHdlr: service-id=16, is-reentrant=false, call-type=INTERRUPT, execution-context=INTERRUPT-CAT-1, sw-service-impl-policy=STANDARD
    Eth_TxDmaCh0IrqHdlr: service-id=17, is-reentrant=false, call-type=INTERRUPT, execution-context=INTERRUPT-CAT-1, sw-service-impl-policy=STANDARD
    Eth_GetVersionInfo: service-id=13, is-reentrant=true, call-type=REGULAR, execution-context=TASK, sw-service-impl-policy=MACRO
      sw service arg VersioninfoPtr: category=DATA_REFERENCE, sw-pointer-target-props={target-category=TYPE_REFERENCE, implementation-data-type=Std_VersionInfoType}
    Eth_SetPhysAddr: service-id=19, is-reentrant=false, call-type=REGULAR, execution-context=TASK, sw-service-impl-policy=STANDARD
      sw service arg CtrlIdx: implementation-data-type=uint8
      sw service arg PhysAddrPtr: category=DATA_REFERENCE, sw-pointer-target-props={target-category=TYPE_REFERENCE, implementation-data-type=uint8}
    Eth_UpdatePhysAddrFilter: service-id=18, is-reentrant=false, call-type=REGULAR, execution-context=TASK, sw-service-impl-policy=STANDARD
      return type Return: implementation-data-type=Std_ReturnType
      sw service arg CtrlIdx: implementation-data-type=uint8
      sw service arg PhysAddrPtr: category=DATA_REFERENCE, sw-pointer-target-props={target-category=TYPE_REFERENCE, implementation-data-type=uint8}
      sw service arg Action: category=DATA_REFERENCE, sw-pointer-target-props=Eth_FilterActionType
    Eth_GetDropCount: service-id=20, is-reentrant=false, call-type=REGULAR, execution-context=TASK, sw-service-impl-policy=STANDARD
      return type Return: implementation-data-type=Std_ReturnType
      sw service arg CtrlIdx: implementation-data-type=uint8
      sw service arg CountValues: category=DATA_REFERENCE, sw-pointer-target-props={target-category=TYPE_REFERENCE, implementation-data-type=uint8}
      sw service arg DropCount: category=DATA_REFERENCE, sw-pointer-target-props={target-category=TYPE_REFERENCE, implementation-data-type=uint32}
    Eth_GetEtherStats: service-id=21, is-reentrant=false, call-type=REGULAR, execution-context=TASK, sw-service-impl-policy=STANDARD
      return type Return: implementation-data-type=Std_ReturnType
      sw service arg CtrlIdx: implementation-data-type=uint8
      sw service arg etherStats: category=DATA_REFERENCE, sw-pointer-target-props={target-category=TYPE_REFERENCE, implementation-data-type=uint32}
    Eth_GetIngressTimeStamp: service-id=25, is-reentrant=false, call-type=REGULAR, execution-context=TASK, sw-service-impl-policy=STANDARD
      4 x sw service arg:
        CtrlIdx: implementation-data-type=uint8
        DataPtr: category=DATA_REFERENCE, sw-pointer-target-props={target-category=TYPE_REFERENCE, implementation-data-type=Eth_DataType}
        timeQualPtr: category=DATA_REFERENCE, sw-pointer-target-props={target-category=TYPE_REFERENCE, implementation-data-type=Eth_TimeStampQualType}
        timeStampPtr: category=DATA_REFERENCE, sw-pointer-target-props={target-category=TYPE_REFERENCE, implementation-data-type=Eth_TimeStampType}
    Eth_SetCorrectionTime: service-id=26, is-reentrant=false, call-type=REGULAR, execution-context=TASK, sw-service-impl-policy=STANDARD
      sw service arg CtrlIdx: implementation-data-type=uint8
      sw service arg timeOffsetPtr: category=DATA_REFERENCE, sw-pointer-target-props={target-category=TYPE_REFERENCE, implementation-data-type=Eth_TimeIntDiffType}
      sw service arg rateRatioPtr: category=DATA_REFERENCE, sw-pointer-target-props={target-category=TYPE_REFERENCE, implementation-data-type=Eth_RateRatioType}
    Eth_SetGlobalTime: service-id=27, is-reentrant=false, call-type=REGULAR, execution-context=TASK, sw-service-impl-policy=STANDARD
      return type Return: implementation-data-type=Std_ReturnType
      sw service arg CtrlIdx: implementation-data-type=uint8
      sw service arg timeStampPtr: category=DATA_REFERENCE, sw-pointer-target-props={target-category=TYPE_REFERENCE, implementation-data-type=Eth_TimeStampType}
    Eth_EnableEgressTimeStamp: service-id=23, is-reentrant=false, call-type=REGULAR, execution-context=TASK, sw-service-impl-policy=STANDARD
      sw service arg CtrlIdx: implementation-data-type=uint8
      sw service arg BufIdx: implementation-data-type=uint8
    Eth_GetCurrentTime: service-id=22, is-reentrant=false, call-type=REGULAR, execution-context=TASK, sw-service-impl-policy=STANDARD
      return type Return: implementation-data-type=Std_ReturnType
      sw service arg CtrlIdx: implementation-data-type=uint8
      sw service arg timeQualPtr: category=DATA_REFERENCE, sw-pointer-target-props={target-category=TYPE_REFERENCE, implementation-data-type=Eth_TimeStampQualType}
      sw service arg timeStampPtr: category=DATA_REFERENCE, sw-pointer-target-props={target-category=TYPE_REFERENCE, implementation-data-type=Eth_TimeStampType}
    Eth_GetEgressTimeStamp: service-id=24, is-reentrant=false, call-type=REGULAR, execution-context=TASK, sw-service-impl-policy=STANDARD
      4 x sw service arg:
        CtrlIdx: implementation-data-type=uint8
        BufIdx: implementation-data-type=uint8
        timeQualPtr: category=DATA_REFERENCE, sw-pointer-target-props={target-category=TYPE_REFERENCE, implementation-data-type=Eth_TimeStampQualType}
        timeStampPtr: category=DATA_REFERENCE, sw-pointer-target-props={target-category=TYPE_REFERENCE, implementation-data-type=Eth_TimeStampType}
    Eth_MainFunction: service-id=32, is-reentrant=false, call-type=REGULAR, execution-context=TASK, sw-service-impl-policy=STANDARD
package /AUTOSAR_Eth_17_GEthMac/Implementations
  bsw implementation Eth: programming-language=C, sw-version=20.25.0, vendor-id=17, ar-release-version=4.2.2, behavior=EthBehavior, vendor-api-infix=GEthMac, vendor-specific-module-def=Eth
    code-descriptors:
      code Files
        artifact-descriptors:
          short-label=src::Eth_17_GEthMac.c, category=SWSRC
          short-label=inc::Eth_17_GEthMac.h, category=SWHDR
          short-label=inc::Eth_17_GEthMac_Types.h, category=SWHDR
    generated-artifacts:
      5 x dependency on artifact:
        Eth_PBcfg_c: artifact-descriptor={short-label=generate::src::Eth_17_GEthMac_PBcfg.c, category=SWTEMPLATE}, usages=EXECUTE
        Eth_Cfg_h: artifact-descriptor={short-label=generate::inc::Eth_17_GEthMac_Cfg.h, category=SWTEMPLATE}, usages=COMPILE
        Eth_PBcfg_h: artifact-descriptor={short-label=generate::template::inc::Eth_17_GEthMac_PBcfg.h, category=SWTEMPLATE}, usages=EXECUTE
        Eth_xdm: artifact-descriptor={short-label=config::Eth_17_GEthMac.xdm, category=SWTOOL}, usages=CODEGENERATION
        Eth_bmd: artifact-descriptor={short-label=autosar::TC37x::TC375x::Eth_17_GEthMac.bmd, category=SWTOOL}, usages=CODEGENERATION
    resource consumption ResourceConsumption
      10 x memory section:
        CONST_QM_GLOBAL_UNSPECIFIED: alignment=UNSPECIFIED, sw-addrmethod=CONST
        CODE_QM_GLOBAL: alignment=UNSPECIFIED, sw-addrmethod=CODE
        VAR_CLEARED_QM_GLOBAL_UNSPECIFIED: alignment=UNSPECIFIED, sw-addrmethod=VAR_CLEARED
        CONFIG_DATA_QM_GLOBAL_UNSPECIFIED: alignment=UNSPECIFIED, sw-addrmethod=CONFIG_DATA
        VAR_CLEARED_QM_CORE0_UNSPECIFIED: alignment=UNSPECIFIED, sw-addrmethod=VAR_CLEARED
        VAR_CLEARED_QM_CORE0_32: alignment=32, sw-addrmethod=VAR_CLEARED
        VAR_TXBUFFER_CLEARED_QM_CORE0_32: alignment=32, sw-addrmethod=VAR_TXBUFFER_CLEARED
        VAR_RXBUFFER_CLEARED_QM_CORE0_32: alignment=32, sw-addrmethod=VAR_RXBUFFER_CLEARED
        CONFIG_DATA_QM_CORE0_UNSPECIFIED: alignment=UNSPECIFIED, sw-addrmethod=CONFIG_DATA
        VAR_INIT_QM_CORE0_UNSPECIFIED: alignment=UNSPECIFIED, sw-addrmethod=VAR_INIT
      section name prefix ETH_17_GETHMAC
package /AUTOSAR_Eth_17_GEthMac/ImplementationDataTypes
  impl type Eth_17_GEthMac_ConfigType: category=STRUCTURE, type-emitter=BSW
    element EthCoreAdd: category=DATA_REFERENCE, sw-pointer-target-props={target-category=TYPE_REFERENCE, implementation-data-type=Eth_17_GEthMac_CoreConfigType}
    element EthNodeIdxmapPtr: category=DATA_REFERENCE, sw-pointer-target-props={target-category=TYPE_REFERENCE, implementation-data-type=uint8}
  impl type Eth_17_GEthMac_CoreCntrlConfigType: category=STRUCTURE, type-emitter=BSW
    21 x element, all with category=TYPE_REFERENCE:
      EthCtrlRxBufLenByte: implementation-data-type=uint16
      EthCtrlRxBufLenByteAligned: implementation-data-type=uint16
      EthCtrlTxBufLenByte: implementation-data-type=uint16
      EthCtrlTxBufLenByteAligned: implementation-data-type=uint16
      EthSkewDelay: implementation-data-type=uint32
      EthGptclRegVal: implementation-data-type=uint32
      EthCntrlProperties: implementation-data-type=uint16
      EthCntrlIdx: implementation-data-type=uint8
      EthMdcRegVal: implementation-data-type=uint8
      EthDemAccess: implementation-data-type=Dem_EventIdType
      EthDemFramesLost: implementation-data-type=Dem_EventIdType
      EthDemAlignment: implementation-data-type=Dem_EventIdType
      EthDemCRC: implementation-data-type=Dem_EventIdType
      EthDemUndersize: implementation-data-type=Dem_EventIdType
      EthDemOversize: implementation-data-type=Dem_EventIdType
      EthRxBufTotal: implementation-data-type=uint8
      EthDemSingleCollision: implementation-data-type=Dem_EventIdType
      EthTxBufTotal: implementation-data-type=uint8
      EthDemLateCollision: implementation-data-type=Dem_EventIdType
      EthMacAddress: array-size=6, array-size-semantics=FIXED-SIZE, implementation-data-type=uint8
      EthDemMultipleCollision: implementation-data-type=Dem_EventIdType
  impl type Eth_17_GEthMac_CoreConfigType: category=STRUCTURE, type-emitter=BSW
    element EthCoreCntrlPtr: category=DATA_REFERENCE, sw-pointer-target-props={target-category=TYPE_REFERENCE, implementation-data-type=Eth_17_GEthMac_CoreCntrlConfigType}
    element EthMaxControllers: implementation-data-type=uint8
