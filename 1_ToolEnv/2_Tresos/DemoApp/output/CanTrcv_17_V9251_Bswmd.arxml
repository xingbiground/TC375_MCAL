AUTOSAR XML (schema 4-2-2)
# Copyright (C) Infineon Technologies (2022)
# All rights reserved.
package /AUTOSAR_CanTrcv_17_V9251/BswModuleDescriptions
  bsw module description CanTrcv: category=BSW_MODULE, module-id=70  # CanTrcv 9251 Driver
    provided-entrys:
      CanTrcv_17_V9251_Init
      CanTrcv_17_V9251_SetOpMode
      CanTrcv_17_V9251_GetOpMode
      CanTrcv_17_V9251_GetBusWuReason
      CanTrcv_17_V9251_SetWakeupMode
      CanTrcv_17_V9251_CheckWakeup
    5 x bsw module dependency:
      DetDependency: target-module-id=15, required-entrys=Det_ReportError
      McalLibDependency: target-module-id=255, required-entrys=[Mcal_DelayTickResolution, Mcal_DelayGetTick, Mcal_SetBitAtomic]
      CanIfDependency: target-module-id=60, required-entrys=CanIf_TrcvModeIndication
      EcuMDependency: target-module-id=10, required-entrys=EcuM_SetWakeupEvent
      DioDependency: target-module-id=120, required-entrys=Dio_WriteChannel
    bsw internal behavior CanTrcvBehavior
      6 x bsw called entity:
        CanTrcv_17_V9251_Init: reentrancy-level=NON-REENTRANT, implemented-entry=CanTrcv_17_V9251_Init
        CanTrcv_17_V9251_SetOpMode: reentrancy-level=SINGLE-CORE-REENTRANT, implemented-entry=CanTrcv_17_V9251_SetOpMode
        CanTrcv_17_V9251_GetOpMode: reentrancy-level=SINGLE-CORE-REENTRANT, implemented-entry=CanTrcv_17_V9251_GetOpMode
        CanTrcv_17_V9251_GetBusWuReason: reentrancy-level=SINGLE-CORE-REENTRANT, implemented-entry=CanTrcv_17_V9251_GetBusWuReason
        CanTrcv_17_V9251_SetWakeupMode: reentrancy-level=SINGLE-CORE-REENTRANT, implemented-entry=CanTrcv_17_V9251_SetWakeupMode
        CanTrcv_17_V9251_CheckWakeup: reentrancy-level=SINGLE-CORE-REENTRANT, implemented-entry=CanTrcv_17_V9251_CheckWakeup
package /AUTOSAR_CanTrcv_17_V9251/BswModuleEntrys
  6 x bsw module entry, all with call-type=REGULAR, execution-context=TASK, sw-service-impl-policy=STANDARD:
    CanTrcv_17_V9251_Init: service-id=0, is-reentrant=false, is-synchronous=true
      sw service arg ConfigPtr: category=DATA_REFERENCE, sw-pointer-target-props={target-category=TYPE_REFERENCE, implementation-data-type=CanTrcv_17_V9251_ConfigType}
    CanTrcv_17_V9251_SetOpMode: service-id=1, is-reentrant=true, is-synchronous=false
      return type Return: implementation-data-type=Std_ReturnType
      sw service arg Transceiver: implementation-data-type=uint8
      sw service arg OpMode: implementation-data-type=CanTrcv_TrcvModeType
    CanTrcv_17_V9251_GetOpMode: service-id=2, is-reentrant=true, is-synchronous=true
      return type Return: implementation-data-type=Std_ReturnType
      sw service arg Transceiver: implementation-data-type=uint8
      sw service arg OpMode: category=DATA_REFERENCE, sw-pointer-target-props={target-category=TYPE_REFERENCE, implementation-data-type=CanTrcv_TrcvModeType}
    CanTrcv_17_V9251_GetBusWuReason: service-id=3, is-reentrant=true, is-synchronous=true
      return type Return: implementation-data-type=Std_ReturnType
      sw service arg Transceiver: implementation-data-type=uint8
      sw service arg reason: category=DATA_REFERENCE, sw-pointer-target-props={target-category=TYPE_REFERENCE, implementation-data-type=CanTrcv_TrcvWakeupReasonType}
    CanTrcv_17_V9251_SetWakeupMode: service-id=5, is-reentrant=true, is-synchronous=true
      return type Return: implementation-data-type=Std_ReturnType
      sw service arg Transceiver: implementation-data-type=uint8
      sw service arg TrcvWakeupMode: implementation-data-type=CanTrcv_TrcvWakeupModeType
    CanTrcv_17_V9251_CheckWakeup: service-id=7, is-reentrant=true, is-synchronous=true
      return type Return: implementation-data-type=Std_ReturnType
      sw service arg Transceiver: implementation-data-type=uint8
package /AUTOSAR_CanTrcv_17_V9251/Implementations
  bsw implementation Cantrcv: programming-language=C, sw-version=20.20.0, vendor-id=17, ar-release-version=4.2.2, behavior=CanTrcvBehavior, vendor-specific-module-def=CanTrcv
    code-descriptors:
      code Files
        artifact-descriptors:
          short-label=ssc::src::CanTrcv_17_V9251.c, category=SWSRC
          short-label=ssc::inc::CanTrcv_17_V9251.h, category=SWHDR
    generated-artifacts:
      4 x dependency on artifact:
        CanTrcv_Cfg_c: artifact-descriptor={short-label=generate::src::CanTrcv_17_V9251_Cfg.c, category=SWTEMPLATE}, usages=COMPILE
        CanTrcv_Cfg_h: artifact-descriptor={short-label=generate::inc::CanTrcv_17_V9251_Cfg.h, category=SWTEMPLATE}, usages=COMPILE
        CanTrcv_xdm: artifact-descriptor={short-label=config::CanTrcv_17_V9251.xdm, category=SWTOOL}, usages=CODEGENERATION
        CanTrcv_bmd: artifact-descriptor={short-label=autosar::TC37x::TC377x::CanTrcv_17_V9251.bmd, category=SWTOOL}, usages=CODEGENERATION
    resource consumption ResourceConsumption
      6 x memory section:
        SEC_VAR_CLEARED_QM_LOCAL_16: alignment=16, sw-addrmethod=VAR
        SEC_VAR_CLEARED_QM_LOCAL_8: alignment=8, sw-addrmethod=VAR
        SEC_CODE_QM_LOCAL: alignment=UNSPECIFIED, sw-addrmethod=CODE
        SEC_VAR_CLEARED_QM_LOCAL_UNSPECIFIED: alignment=UNSPECIFIED, sw-addrmethod=VAR
        SEC_CONFIG_DATA_QM_LOCAL_8: alignment=8, sw-addrmethod=CONFIG
        SEC_CONFIG_DATA_QM_LOCAL_UNSPECIFIED: alignment=UNSPECIFIED, sw-addrmethod=CONFIG
      section name prefix CANTRCV_17_V9251
package /AUTOSAR_CanTrcv_17_V9251/ImplementationDataTypes
  impl type CanTrcv_17_V9251_ConfigType: implementation-data-type=void, type-emitter=BSW
  impl type CanTrcv_17_V9251_ChannelInfoType: category=STRUCTURE, type-emitter=BSW
    6 x element, all with category=TYPE_REFERENCE:
      CanTrcv_17_V9251_NetworkMode: implementation-data-type=CanTrcv_TrcvModeType
      CanTrcv_17_V9251_WakeupSourceRef: implementation-data-type=EcuM_WakeupSourceType
      CanTrcv_17_V9251_DioChannel: implementation-data-type=Dio_ChannelType
      CanTrcv_17_V9251_DioPinLevel: implementation-data-type=Dio_LevelType
      CanTrcv_17_V9251_ChannelId: implementation-data-type=uint8
      CanTrcv_17_V9251_WakeupbyBus: implementation-data-type=boolean
