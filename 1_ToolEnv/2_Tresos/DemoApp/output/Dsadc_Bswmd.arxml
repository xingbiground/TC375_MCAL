AUTOSAR XML (schema 4-2-2)
# Copyright (C) Infineon Technologies (2023)
# All rights reserved.
package /AURIX2G_Dsadc/BswModuleDescriptions
  bsw module description Dsadc: category=BSW_MODULE, module-id=255  # DSADC Driver
    provided-entrys:
      Dsadc_Init
      Dsadc_StartModulation
      Dsadc_StopModulation
      Dsadc_ReadResult
      Dsadc_GetStatus
      Dsadc_StartCarrierSignal
      Dsadc_StopCarrierSignal
      Dsadc_EnableNotifications
      Dsadc_DisableNotifications
      Dsadc_GetTimestamp
      Dsadc_StartCalibration
      Dsadc_GetCalibrationStatus
      Dsadc_InitCheck
      Dsadc_RestartDemodulator
      Dsadc_GetIrmsValue
      Dsadc_SetGainCorrRegValue
      Dsadc_GetSdcapValue
    4 x bsw module dependency:
      DetDependency: target-module-id=15, required-entrys=Det_ReportError
      McalWrapperDependency: target-module-id=255, required-entrys=Mcal_Wrapper_Dem_ReportErrorStatus
      McalLibDependency: target-module-id=255
        required-entrys:
          Mcal_WritePeripEndInitProtReg
          Mcal_WriteSafetyEndInitProtRegMask
          Mcal_GetBitAtomic
          Mcal_SetBitAtomic
          Mcal_DelayGetTick
      McalSafetyErrorDependency: target-module-id=255, required-entrys=Mcal_ReportSafetyError
    bsw internal behavior DsadcBehavior
      exclusive area ChannelData
      17 x bsw called entity:
        Dsadc_Init: reentrancy-level=NON-REENTRANT, implemented-entry=Dsadc_Init
        Dsadc_StartModulation: reentrancy-level=MULTICORE-REENTRANT, implemented-entry=Dsadc_StartModulation
        Dsadc_StopModulation: reentrancy-level=MULTICORE-REENTRANT, implemented-entry=Dsadc_StopModulation
        Dsadc_ReadResult: can-enter-exclusive-area=ChannelData, reentrancy-level=MULTICORE-REENTRANT, implemented-entry=Dsadc_ReadResult
        Dsadc_GetStatus: reentrancy-level=MULTICORE-REENTRANT, implemented-entry=Dsadc_GetStatus
        Dsadc_StartCarrierSignal: reentrancy-level=NON-REENTRANT, implemented-entry=Dsadc_StartCarrierSignal
        Dsadc_StopCarrierSignal: reentrancy-level=MULTICORE-REENTRANT, implemented-entry=Dsadc_StopCarrierSignal
        Dsadc_EnableNotifications: reentrancy-level=MULTICORE-REENTRANT, implemented-entry=Dsadc_EnableNotifications
        Dsadc_DisableNotifications: reentrancy-level=MULTICORE-REENTRANT, implemented-entry=Dsadc_DisableNotifications
        Dsadc_GetTimestamp: reentrancy-level=MULTICORE-REENTRANT, implemented-entry=Dsadc_GetTimestamp
        Dsadc_StartCalibration: reentrancy-level=MULTICORE-REENTRANT, implemented-entry=Dsadc_StartCalibration
        Dsadc_GetCalibrationStatus: reentrancy-level=MULTICORE-REENTRANT, implemented-entry=Dsadc_GetCalibrationStatus
        Dsadc_InitCheck: reentrancy-level=NON-REENTRANT, implemented-entry=Dsadc_InitCheck
        Dsadc_RestartDemodulator: reentrancy-level=MULTICORE-REENTRANT, implemented-entry=Dsadc_RestartDemodulator
        Dsadc_GetIrmsValue: reentrancy-level=MULTICORE-REENTRANT, implemented-entry=Dsadc_GetIrmsValue
        Dsadc_SetGainCorrRegValue: reentrancy-level=NON-REENTRANT, implemented-entry=Dsadc_SetGainCorrRegValue
        Dsadc_GetSdcapValue: reentrancy-level=MULTICORE-REENTRANT, implemented-entry=Dsadc_GetSdcapValue
      service-needs:
        diagnostic event needs DSADC_E_CLC_FAILURE
      service-needs:
        diagnostic event needs DSADC_E_FIFO_FAILURE
package /AURIX2G_Dsadc/BswModuleEntrys
  17 x bsw module entry, all with is-synchronous=true, call-type=REGULAR, execution-context=TASK, sw-service-impl-policy=STANDARD:
    Dsadc_Init: service-id=26, is-reentrant=false
      sw service arg ConfigPtr: category=DATA_REFERENCE, sw-pointer-target-props={target-category=TYPE_REFERENCE, implementation-data-type=Dsadc_ConfigType}
    Dsadc_StartModulation: service-id=28, is-reentrant=true
      return type Return: implementation-data-type=Std_ReturnType
      sw service arg ChannelId: implementation-data-type=Dsadc_ChannelType
    Dsadc_StopModulation: service-id=29, is-reentrant=true
      return type Return: implementation-data-type=Std_ReturnType
      sw service arg ChannelId: implementation-data-type=Dsadc_ChannelType
    Dsadc_ReadResult: service-id=31, is-reentrant=true
      return type Return: implementation-data-type=Std_ReturnType
      sw service arg ChannelId: implementation-data-type=Dsadc_ChannelType
      sw service arg ResultPtr: category=DATA_REFERENCE, sw-pointer-target-props={target-category=TYPE_REFERENCE, implementation-data-type=Dsadc_ResultType}
    Dsadc_GetStatus: service-id=32, is-reentrant=true
      return type Return: implementation-data-type=Dsadc_ChannelstatusType
      sw service arg ChannelId: implementation-data-type=Dsadc_ChannelType
    Dsadc_StartCarrierSignal: service-id=34, is-reentrant=false
      return type Return: implementation-data-type=Std_ReturnType
    Dsadc_StopCarrierSignal: service-id=35, is-reentrant=true
      return type Return: implementation-data-type=Std_ReturnType
    Dsadc_EnableNotifications: service-id=36, is-reentrant=true
      sw service arg ChannelId: implementation-data-type=Dsadc_ChannelType
    Dsadc_DisableNotifications: service-id=37, is-reentrant=true
      sw service arg ChannelId: implementation-data-type=Dsadc_ChannelType
    Dsadc_GetTimestamp: service-id=38, is-reentrant=true
      return type Return: implementation-data-type=Dsadc_TimeStampType
      sw service arg ChannelId: implementation-data-type=Dsadc_ChannelType
    Dsadc_StartCalibration: service-id=39, is-reentrant=true
      return type Return: implementation-data-type=Std_ReturnType
      sw service arg ChannelId: implementation-data-type=Dsadc_ChannelType
    Dsadc_GetCalibrationStatus: service-id=40, is-reentrant=true
      return type Return: implementation-data-type=Dsadc_CalibrationStatusType
      sw service arg ChannelId: implementation-data-type=Dsadc_ChannelType
    Dsadc_RestartDemodulator: service-id=45, is-reentrant=true
      return type Return: implementation-data-type=Std_ReturnType
      sw service arg ChannelId: implementation-data-type=Dsadc_ChannelMaskType
    Dsadc_GetIrmsValue: service-id=46, is-reentrant=true
      return type Return: implementation-data-type=Dsadc_IrmsValueType
      sw service arg ChannelId: implementation-data-type=Dsadc_ChannelType
    Dsadc_SetGainCorrRegValue: service-id=240, is-reentrant=false
      return type Return: implementation-data-type=Std_ReturnType
      sw service arg ChannelId: implementation-data-type=Dsadc_ChannelType
      sw service arg RegValue: implementation-data-type=Dsadc_GainCorrType
    Dsadc_GetSdcapValue: service-id=242, is-reentrant=true
      return type Return: implementation-data-type=Dsadc_SdcapValueType
      sw service arg ChannelId: implementation-data-type=Dsadc_ChannelType
    Dsadc_InitCheck: service-id=41, is-reentrant=false
      return type Return: implementation-data-type=Std_ReturnType
      sw service arg ConfigPtr: category=DATA_REFERENCE, sw-pointer-target-props={target-category=TYPE_REFERENCE, implementation-data-type=Dsadc_ConfigType}
package /AURIX2G_Dsadc/Implementations
  bsw implementation Dsadc: programming-language=C, sw-version=20.25.0, vendor-id=17, ar-release-version=4.2.2, behavior=DsadcBehavior, vendor-specific-module-def=Dsadc
    code-descriptors:
      code Files
        artifact-descriptors:
          short-label=ssc::src::Dsadc.c, category=SWSRC
          short-label=ssc::inc::Dsadc.h, category=SWHDR
          short-label=ssc::inc::Dsadc_Cbk.h, category=SWHDR
    generated-artifacts:
      4 x dependency on artifact:
        Dsadc_PBcfg_c: artifact-descriptor={short-label=generate::template::src::Dsadc_PBcfg.c, category=SWTEMPLATE}, usages=EXECUTE
        Dsadc_PBcfg_h: artifact-descriptor={short-label=generate::template::inc::Dsadc_PBcfg.h, category=SWTEMPLATE}, usages=EXECUTE
        Dsadc_Cfg_h: artifact-descriptor={short-label=generate::template::inc::Dsadc_Cfg.h, category=COMPILE}, usages=CODEGENERATION
        Dsadc_bmd: artifact-descriptor={short-label=autosar::TC37x::TC375x::Dsadc.bmd, category=SWTOOL}, usages=CODEGENERATION
    resource consumption ResourceConsumption
      4 x memory section:
        CONFIG_DATA_ASIL_B_LOCAL_UNSPECIFIED: alignment=UNSPECIFIED, sw-addrmethod=CONFIG_DATA
        CODE_ASIL_B_LOCAL: alignment=UNSPECIFIED, sw-addrmethod=CODE
        VAR_CLEARED_ASIL_B_LOCAL_32: alignment=32, sw-addrmethod=VAR_CLEARED
        VAR_CLEARED_ASIL_B_LOCAL_8: alignment=8, sw-addrmethod=VAR_CLEARED
      section name prefix DSADC
package /AURIX2G_Dsadc/ImplementationDataTypes
  14 x impl type, all with type-emitter=BSW:
    Dsadc_CalibrationStatusType: compu {0=DSADC_CALIBRATION_NOT_STARTED, 1=DSADC_CALIBRATION_RUNNING, 2=DSADC_CALIBRATION_DONE, 3=DSADC_CALIBRATION_ERROR}, implementation-data-type=uint8
    Dsadc_ChannelstatusType: compu {0=DSADC_IDLE, 1=DSADC_BUSY, 2=DSADC_RESULT_READY}, implementation-data-type=uint8
    Dsadc_ChannelType: implementation-data-type=uint8
    Dsadc_NotifyFnPtrType: category=FUNCTION_REFERENCE, sw-pointer-target-props={target-category=FUNCTION_REFERENCE, function-pointer-signature=Dsadc_NewResultNotif}
    Dsadc_ResultType: implementation-data-type=sint16
    Dsadc_TimeStampType: implementation-data-type=uint16
    Dsadc_ChannelConfigType: category=STRUCTURE
      28 x element:
        Dsadc_EruOguConf: category=DATA_REFERENCE, sw-pointer-target-props={target-category=TYPE_REFERENCE, implementation-data-type=Dsadc_EruOguConfigType}
        ModulatorConfigReg: implementation-data-type=uint32
        CommonModeVoltConfigReg: implementation-data-type=uint32
        DemodulatorConfigReg: implementation-data-type=uint32
        FilterConfigReg: implementation-data-type=uint32
        CICFilterConfigReg: implementation-data-type=uint32
        AuxCICFilterConfigReg: implementation-data-type=uint32
        TimeStampConfigReg: implementation-data-type=uint32
        IntegratorConfigReg: implementation-data-type=uint32
        ResultFifoConfigReg: implementation-data-type=uint32
        OffsetCompConfigReg: implementation-data-type=uint32
        GainCalibConfigReg: implementation-data-type=uint32
        GainControlConfigReg: implementation-data-type=uint32
        GainCorrConfigReg: implementation-data-type=uint32
        LimitCheckingConfigReg: implementation-data-type=uint32
        OvershootCompenconfigReg: implementation-data-type=uint32
        CarrierGenSyncConfigReg: implementation-data-type=uint32
        RectificationConfigReg: implementation-data-type=uint32
        HwAssignedChannelNum: implementation-data-type=uint8
        AccessMode: implementation-data-type=uint8
        TimestampMode: implementation-data-type=uint8
        TriggerMode: implementation-data-type=uint8
        TriggerSource: implementation-data-type=uint8
        GateActiveLevel: implementation-data-type=uint8
        ChannelIntMode: implementation-data-type=uint8
        BufferFullNotifyPtr: implementation-data-type=Dsadc_NotifyFnPtrType
        NewResultNotifyPtr: implementation-data-type=Dsadc_NotifyFnPtrType
        WindowCloseNotifiPtr: implementation-data-type=Dsadc_NotifyFnPtrType
    Dsadc_ConfigType: category=STRUCTURE
      6 x element, all with category=TYPE_REFERENCE:
        DsadcChannelConfiguration: implementation-data-type=Dsadc_ChannelConfigType
        DsadcEruErsConfig: implementation-data-type=Dsadc_EruErsConfigType
        DsadcClcCtrlReg: implementation-data-type=uint32
        GlobalConfigReg: implementation-data-type=uint32
        CarrierGenConfigReg: implementation-data-type=uint32
        CGWaveform: implementation-data-type=uint32
    Dsadc_EruErsConfigType: category=STRUCTURE
      element EruErsEicr: implementation-data-type=uint16
      element ErsChannelNo: implementation-data-type=uint8
    Dsadc_EruOguConfigType: category=STRUCTURE
      element EruOguIgcr: implementation-data-type=uint16
      element OguChannelNo: implementation-data-type=uint8
    Dsadc_IrmsValueType: implementation-data-type=uint16
    Dsadc_GainCorrType: implementation-data-type=uint32
    Dsadc_ChannelMaskType: implementation-data-type=uint32
    Dsadc_SdcapValueType: implementation-data-type=uint8
