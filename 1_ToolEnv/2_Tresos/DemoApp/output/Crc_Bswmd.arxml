AUTOSAR XML (schema 4-2-2)
# Copyright (C) Infineon Technologies (2022)
# All rights reserved.
package /AUTOSAR_Crc/BswModuleDescriptions
  bsw module description Crc: category=BSW_MODULE, module-id=201  # Cyclic Redundacy Check
    provided-entrys:
      Crc_CalculateCRC8
      Crc_CalculateCRC8H2F
      Crc_CalculateCRC16
      Crc_CalculateCRC32
      Crc_CalculateCRC32P4
      Crc_GetVersionInfo
    bsw module dependency McalLibDependency: target-module-id=255, required-entrys=Mcal_WritePeripEndInitProtReg
    bsw module dependency McalSafetyErrorDependency: target-module-id=255, required-entrys=Mcal_ReportSafetyError
    bsw internal behavior CrcBehavior
      6 x bsw called entity, all with reentrancy-level=MULTICORE-REENTRANT:
        Crc_CalculateCRC8: implemented-entry=Crc_CalculateCRC8
        Crc_CalculateCRC8H2F: implemented-entry=Crc_CalculateCRC8H2F
        Crc_CalculateCRC16: implemented-entry=Crc_CalculateCRC16
        Crc_CalculateCRC32: implemented-entry=Crc_CalculateCRC32
        Crc_CalculateCRC32P4: implemented-entry=Crc_CalculateCRC32P4
        Crc_GetVersionInfo: implemented-entry=Crc_GetVersionInfo
package /AUTOSAR_Crc/BswModuleEntrys
  6 x bsw module entry, all with is-reentrant=true, is-synchronous=true, call-type=REGULAR, execution-context=TASK:
    Crc_CalculateCRC8: service-id=1, sw-service-impl-policy=STANDARD
      return type Return: implementation-data-type=uint8
      4 x sw service arg:
        Crc_DataPtr: category=DATA_REFERENCE, sw-pointer-target-props={target-category=TYPE_REFERENCE, implementation-data-type=uint8}
        Crc_Length: implementation-data-type=uint32
        Crc_StartValue8: implementation-data-type=uint8
        Crc_IsFirstCall: implementation-data-type=boolean
    Crc_CalculateCRC8H2F: service-id=5, sw-service-impl-policy=STANDARD
      return type Return: implementation-data-type=uint8
      4 x sw service arg:
        Crc_DataPtr: category=DATA_REFERENCE, sw-pointer-target-props={target-category=TYPE_REFERENCE, implementation-data-type=uint8}
        Crc_Length: implementation-data-type=uint32
        Crc_StartValue8H2F: implementation-data-type=uint8
        Crc_IsFirstCall: implementation-data-type=boolean
    Crc_CalculateCRC16: service-id=2, sw-service-impl-policy=STANDARD
      return type Return: implementation-data-type=uint16
      4 x sw service arg:
        Crc_DataPtr: category=DATA_REFERENCE, sw-pointer-target-props={target-category=TYPE_REFERENCE, implementation-data-type=uint8}
        Crc_Length: implementation-data-type=uint32
        Crc_StartValue16: implementation-data-type=uint16
        Crc_IsFirstCall: implementation-data-type=boolean
    Crc_CalculateCRC32: service-id=3, sw-service-impl-policy=STANDARD
      return type Return: implementation-data-type=uint32
      4 x sw service arg:
        Crc_DataPtr: category=DATA_REFERENCE, sw-pointer-target-props={target-category=TYPE_REFERENCE, implementation-data-type=uint8}
        Crc_Length: implementation-data-type=uint32
        Crc_StartValue32: implementation-data-type=uint32
        Crc_IsFirstCall: implementation-data-type=boolean
    Crc_CalculateCRC32P4: service-id=6, sw-service-impl-policy=STANDARD
      return type Return: implementation-data-type=uint32
      4 x sw service arg:
        Crc_DataPtr: category=DATA_REFERENCE, sw-pointer-target-props={target-category=TYPE_REFERENCE, implementation-data-type=uint8}
        Crc_Length: implementation-data-type=uint32
        Crc_StartValue32: implementation-data-type=uint32
        Crc_IsFirstCall: implementation-data-type=boolean
    Crc_GetVersionInfo: service-id=4, sw-service-impl-policy=MACRO
      sw service arg Versioninfo: category=DATA_REFERENCE, sw-pointer-target-props={target-category=TYPE_REFERENCE, implementation-data-type=Std_VersionInfoType}
package /AUTOSAR_Crc/Implementations
  bsw implementation Crc: programming-language=C, sw-version=20.20.0, vendor-id=17, ar-release-version=4.2.2, behavior=CrcBehavior, vendor-specific-module-def=Crc
    code-descriptors:
      code Files: artifact-descriptors=[{short-label=ssc::src::Crc.c, category=SWSRC}, {short-label=ssc::inc::Crc.h, category=SWHDR}]
    generated-artifacts:
      4 x dependency on artifact:
        Crc_Cfg_h: artifact-descriptor={short-label=generate::template::inc::Crc_Cfg.h, category=SWTEMPLATE}, usages=COMPILE
        Crc_Cfg_c: artifact-descriptor={short-label=generate::template::src::Crc_Cfg.c, category=SWTEMPLATE}, usages=COMPILE
        Crc_xdm: artifact-descriptor={short-label=config::Crc.xdm, category=SWTOOL}, usages=CODEGENERATION
        Crc_bmd: artifact-descriptor={short-label=autosar::TC37x::TC377x::Crc.bmd, category=SWTOOL}, usages=CODEGENERATION
    resource consumption ResourceConsumption
      10 x memory section:
        CONFIG_DATA_ASIL_B_GLOBAL_32: alignment=32, sw-addrmethod=CONFIG_DATA
        CONFIG_DATA_ASIL_B_GLOBAL_UNSPECIFIED: alignment=UNSPECIFIED, sw-addrmethod=CONFIG_DATA
        CONST_ASIL_B_GLOBAL_UNSPECIFIED: alignment=UNSPECIFIED, sw-addrmethod=CONST
        VAR_INIT_ASIL_B_CORE{0..5}_32: alignment=32, sw-addrmethod=VAR_INIT
        CODE_ASIL_B_GLOBAL: alignment=UNSPECIFIED, sw-addrmethod=CODE
      section name prefix CRC
