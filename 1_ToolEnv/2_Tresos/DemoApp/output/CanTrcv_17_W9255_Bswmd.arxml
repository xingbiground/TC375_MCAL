AUTOSAR XML (schema 4-2-2)
# Copyright (C) Infineon Technologies (2023)
# All rights reserved.
package /AUTOSAR_CanTrcv_17_W9255/BswModuleDescriptions
  bsw module description CanTrcv: category=BSW_MODULE, module-id=70  # CanTrcv W9255 Driver
    provided-entrys:
      CanTrcv_17_W9255_Init
      CanTrcv_17_W9255_SetOpMode
      CanTrcv_17_W9255_GetOpMode
      CanTrcv_17_W9255_GetBusWuReason
      CanTrcv_17_W9255_SetWakeupMode
      CanTrcv_17_W9255_CheckWakeup
      CanTrcv_17_W9255_CheckWakeFlag
      CanTrcv_17_W9255_MainFunction
      CanTrcv_17_W9255_ClearTrcvWufFlag
      CanTrcv_17_W9255_ClearTrcvTimeoutFlag
      CanTrcv_17_W9255_GetTrcvSystemData
      CanTrcv_17_W9255_ReadTrcvSilenceFlag
      CanTrcv_17_W9255_ReadTrcvTimeoutFlag
      CanTrcv_17_W9255_SetPNActivationState
    5 x bsw module dependency:
      DetDependency: target-module-id=15, required-entrys=Det_ReportError
      McalLibDependency: target-module-id=255, required-entrys=[Mcal_DelayTickResolution, Mcal_DelayGetTick, Mcal_SetBitAtomic]
      CanIfDependency: target-module-id=60
        required-entrys:
          CanIf_CheckTrcvWakeFlagIndication
          CanIf_ClearTrcvWufFlagIndication
          CanIf_ConfirmPnAvailability
          CanIf_TrcvModeIndication
      EcuMDependency: target-module-id=10, required-entrys=EcuM_SetWakeupEvent
      SpiDependency: target-module-id=83, required-entrys=[Spi_SetupEB, Spi_SyncTransmit]
    bsw internal behavior CanTrcvBehavior
      exclusive area SpiStatusUpdate
      14 x bsw called entity:
        CanTrcv_17_W9255_Init: can-enter-exclusive-area=SpiStatusUpdate, reentrancy-level=NON-REENTRANT, implemented-entry=CanTrcv_17_W9255_Init
        CanTrcv_17_W9255_SetOpMode: can-enter-exclusive-area=SpiStatusUpdate, reentrancy-level=SINGLE-CORE-REENTRANT, implemented-entry=CanTrcv_17_W9255_SetOpMode
        CanTrcv_17_W9255_GetOpMode: can-enter-exclusive-area=SpiStatusUpdate, reentrancy-level=SINGLE-CORE-REENTRANT, implemented-entry=CanTrcv_17_W9255_GetOpMode
        CanTrcv_17_W9255_GetBusWuReason: reentrancy-level=SINGLE-CORE-REENTRANT, implemented-entry=CanTrcv_17_W9255_GetBusWuReason
        CanTrcv_17_W9255_SetWakeupMode: can-enter-exclusive-area=SpiStatusUpdate, reentrancy-level=SINGLE-CORE-REENTRANT, implemented-entry=CanTrcv_17_W9255_SetWakeupMode
        CanTrcv_17_W9255_CheckWakeup: can-enter-exclusive-area=SpiStatusUpdate, reentrancy-level=SINGLE-CORE-REENTRANT, implemented-entry=CanTrcv_17_W9255_CheckWakeup
        CanTrcv_17_W9255_CheckWakeFlag: can-enter-exclusive-area=SpiStatusUpdate, reentrancy-level=NON-REENTRANT, implemented-entry=CanTrcv_17_W9255_CheckWakeFlag
        CanTrcv_17_W9255_ClearTrcvTimeoutFlag: can-enter-exclusive-area=SpiStatusUpdate, reentrancy-level=NON-REENTRANT, implemented-entry=CanTrcv_17_W9255_ClearTrcvTimeoutFlag
        CanTrcv_17_W9255_ClearTrcvWufFlag: can-enter-exclusive-area=SpiStatusUpdate, reentrancy-level=SINGLE-CORE-REENTRANT, implemented-entry=CanTrcv_17_W9255_ClearTrcvWufFlag
        CanTrcv_17_W9255_GetTrcvSystemData: can-enter-exclusive-area=SpiStatusUpdate, reentrancy-level=NON-REENTRANT, implemented-entry=CanTrcv_17_W9255_GetTrcvSystemData
        CanTrcv_17_W9255_ReadTrcvSilenceFlag: can-enter-exclusive-area=SpiStatusUpdate, reentrancy-level=NON-REENTRANT, implemented-entry=CanTrcv_17_W9255_ReadTrcvSilenceFlag
        CanTrcv_17_W9255_ReadTrcvTimeoutFlag: can-enter-exclusive-area=SpiStatusUpdate, reentrancy-level=NON-REENTRANT, implemented-entry=CanTrcv_17_W9255_ReadTrcvTimeoutFlag
        CanTrcv_17_W9255_SetPNActivationState: can-enter-exclusive-area=SpiStatusUpdate, reentrancy-level=NON-REENTRANT, implemented-entry=CanTrcv_17_W9255_SetPNActivationState
        CanTrcv_17_W9255_MainFunction: can-enter-exclusive-area=SpiStatusUpdate, minimum-start-interval=0.005, reentrancy-level=NON-REENTRANT, implemented-entry=CanTrcv_17_W9255_MainFunction
      bsw timing event TimingEvent_CanTrcv_17_W9255_MainFunction: starts-on-event=CanTrcv_17_W9255_MainFunction, period=0.005
package /AUTOSAR_CanTrcv_17_W9255/BswModuleEntrys
  14 x bsw module entry, all with call-type=REGULAR, execution-context=TASK, sw-service-impl-policy=STANDARD:
    CanTrcv_17_W9255_Init: service-id=0, is-reentrant=false, is-synchronous=true
      sw service arg ConfigPtr: category=DATA_REFERENCE, sw-pointer-target-props={target-category=TYPE_REFERENCE, implementation-data-type=CanTrcv_17_W9255_ConfigType}
    CanTrcv_17_W9255_SetOpMode: service-id=1, is-reentrant=true, is-synchronous=false
      return type Return: implementation-data-type=Std_ReturnType
      sw service arg Transceiver: implementation-data-type=uint8
      sw service arg OpMode: implementation-data-type=CanTrcv_TrcvModeType
    CanTrcv_17_W9255_GetOpMode: service-id=2, is-reentrant=true, is-synchronous=true
      return type Return: implementation-data-type=Std_ReturnType
      sw service arg Transceiver: implementation-data-type=uint8
      sw service arg OpMode: category=DATA_REFERENCE, sw-pointer-target-props={target-category=TYPE_REFERENCE, implementation-data-type=CanTrcv_TrcvModeType}
    CanTrcv_17_W9255_GetBusWuReason: service-id=3, is-reentrant=true, is-synchronous=true
      return type Return: implementation-data-type=Std_ReturnType
      sw service arg Transceiver: implementation-data-type=uint8
      sw service arg reason: category=DATA_REFERENCE, sw-pointer-target-props={target-category=TYPE_REFERENCE, implementation-data-type=CanTrcv_TrcvWakeupReasonType}
    CanTrcv_17_W9255_SetWakeupMode: service-id=5, is-reentrant=true, is-synchronous=true
      return type Return: implementation-data-type=Std_ReturnType
      sw service arg Transceiver: implementation-data-type=uint8
      sw service arg TrcvWakeupMode: implementation-data-type=CanTrcv_TrcvWakeupModeType
    CanTrcv_17_W9255_CheckWakeup: service-id=7, is-reentrant=true, is-synchronous=true
      return type Return: implementation-data-type=Std_ReturnType
      sw service arg Transceiver: implementation-data-type=uint8
    CanTrcv_17_W9255_CheckWakeFlag: service-id=14, is-reentrant=false, is-synchronous=false
      return type Return: implementation-data-type=Std_ReturnType
      sw service arg Transceiver: implementation-data-type=uint8
    CanTrcv_17_W9255_ClearTrcvTimeoutFlag: service-id=12, is-reentrant=false, is-synchronous=true
      return type Return: implementation-data-type=Std_ReturnType
      sw service arg Transceiver: implementation-data-type=uint8
    CanTrcv_17_W9255_ClearTrcvWufFlag: service-id=10, is-reentrant=true, is-synchronous=true
      return type Return: implementation-data-type=Std_ReturnType
      sw service arg Transceiver: implementation-data-type=uint8
    CanTrcv_17_W9255_GetTrcvSystemData: service-id=9, is-reentrant=false, is-synchronous=true
      return type Return: implementation-data-type=Std_ReturnType
      sw service arg Transceiver: implementation-data-type=uint8
      sw service arg TrcvSysData: category=DATA_REFERENCE, sw-pointer-target-props={target-category=TYPE_REFERENCE, implementation-data-type=uint32}
    CanTrcv_17_W9255_ReadTrcvSilenceFlag: service-id=13, is-reentrant=false, is-synchronous=true
      return type Return: implementation-data-type=Std_ReturnType
      sw service arg Transceiver: implementation-data-type=uint8
      sw service arg FlagState: category=DATA_REFERENCE, sw-pointer-target-props={target-category=TYPE_REFERENCE, implementation-data-type=CanTrcv_17_W9255_TrcvFlagStateType}
    CanTrcv_17_W9255_ReadTrcvTimeoutFlag: service-id=11, is-reentrant=false, is-synchronous=true
      return type Return: implementation-data-type=Std_ReturnType
      sw service arg Transceiver: implementation-data-type=uint8
      sw service arg FlagState: category=DATA_REFERENCE, sw-pointer-target-props={target-category=TYPE_REFERENCE, implementation-data-type=CanTrcv_17_W9255_TrcvFlagStateType}
    CanTrcv_17_W9255_SetPNActivationState: service-id=15, is-reentrant=false, is-synchronous=true
      return type Return: implementation-data-type=Std_ReturnType
      sw service arg ActivationState: implementation-data-type=CanTrcv_17_W9255_PNActivationType
    CanTrcv_17_W9255_MainFunction: service-id=6, is-reentrant=false, is-synchronous=true
package /AUTOSAR_CanTrcv_17_W9255/Implementations
  bsw implementation Cantrcv: programming-language=C, sw-version=20.25.0, vendor-id=17, ar-release-version=4.2.2, behavior=CanTrcvBehavior, vendor-specific-module-def=CanTrcv
    code-descriptors:
      code Files
        artifact-descriptors:
          short-label=ssc::src::CanTrcv_17_W9255.c, category=SWSRC
          short-label=ssc::inc::CanTrcv_17_W9255.h, category=SWHDR
    generated-artifacts:
      4 x dependency on artifact:
        CanTrcv_Cfg_c: artifact-descriptor={short-label=generate::src::CanTrcv_17_W9255_Cfg.c, category=SWTEMPLATE}, usages=COMPILE
        CanTrcv_Cfg_h: artifact-descriptor={short-label=generate::inc::CanTrcv_17_W9255_Cfg.h, category=SWTEMPLATE}, usages=COMPILE
        CanTrcv_xdm: artifact-descriptor={short-label=config::CanTrcv_17_W9255.xdm, category=SWTOOL}, usages=CODEGENERATION
        CanTrcv_bmd: artifact-descriptor={short-label=autosar::TC37x::TC375x::CanTrcv_17_W9255.bmd, category=SWTOOL}, usages=CODEGENERATION
    resource consumption ResourceConsumption
      7 x memory section:
        SEC_VAR_CLEARED_QM_LOCAL_16: alignment=16, sw-addrmethod=VAR
        SEC_VAR_CLEARED_QM_LOCAL_8: alignment=8, sw-addrmethod=VAR
        SEC_CODE_QM_LOCAL: alignment=UNSPECIFIED, sw-addrmethod=CODE
        SEC_VAR_CLEARED_QM_LOCAL_32: alignment=32, sw-addrmethod=VAR
        SEC_CONFIG_DATA_QM_LOCAL_8: alignment=8, sw-addrmethod=CONFIG
        SEC_CONFIG_DATA_QM_LOCAL_UNSPECIFIED: alignment=UNSPECIFIED, sw-addrmethod=CONFIG
        SEC_CONFIG_DATA_QM_LOCAL_16: alignment=16, sw-addrmethod=CONFIG
      section name prefix CANTRCV_17_W9255
package /AUTOSAR_CanTrcv_17_W9255/ImplementationDataTypes
  5 x impl type, all with type-emitter=BSW:
    CanTrcv_17_W9255_ConfigType: implementation-data-type=void
    CanTrcv_17_W9255_PNActivationType: compu {0=CANTRCV_17_W9255_PN_DISABLED, 1=CANTRCV_17_W9255_PN_ENABLED}, implementation-data-type=sint32, additional-native-type-qualifier=enum
    CanTrcv_17_W9255_TrcvFlagStateType: compu {0=CANTRCV_17_W9255_FLAG_CLEARED, 1=CANTRCV_17_W9255_FLAG_SET}, implementation-data-type=sint32, additional-native-type-qualifier=enum
    CanTrcv_17_W9255_ChannelConfigType: category=STRUCTURE
      8 x element, all with category=TYPE_REFERENCE:
        CanTrcvInitState: implementation-data-type=uint16
        CanTrcvWakeupSourceRef: implementation-data-type=EcuM_WakeupSourceType
        CanTrcvPorWakeupSourceRef: implementation-data-type=EcuM_WakeupSourceType
        CanTrcvSyserrWakeupSourceRef: implementation-data-type=EcuM_WakeupSourceType
        CanTrcvChannelId: implementation-data-type=uint8
        CanTrcvSpiSequence: implementation-data-type=Spi_SequenceType
        CanTrcvSpiChannel: implementation-data-type=Spi_ChannelType
        CanTrcvWakeupByBusEnable: implementation-data-type=boolean
    CanTrcv_17_W9255_PNConfigType: category=STRUCTURE
      element CanTrcvPnIdInfoPtr: category=DATA_REFERENCE, sw-pointer-target-props={target-category=TYPE_REFERENCE, implementation-data-type=uint16}
      element CanTrcvPnDataInfoPtr: category=DATA_REFERENCE, sw-pointer-target-props={target-category=TYPE_REFERENCE, implementation-data-type=uint16}
      element CanTrcvPnDlc: implementation-data-type=uint16
